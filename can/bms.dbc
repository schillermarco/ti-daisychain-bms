NS_ :

BS_:

BU_: PICO_BMS

BO_ 1267 PICO_BMS_temperatures_battery: 5 PICO_BMS
 SG_ PICO_BMS_temperatures_battery_m  M: 7|24@0- (1,0) [0|2] "" Vector__XXX
 SG_ PICO_BMS_FB_temperature_battery_00_00_00  m0: 31|16@0- (0.1,0) [0|100] "C" Vector__XXX
 SG_ PICO_BMS_FB_temperature_battery_00_00_01  m1: 31|16@0- (0.1,0) [0|100] "C" Vector__XXX
 SG_ PICO_BMS_FB_temperature_battery_00_00_02  m2: 31|16@0- (0.1,0) [0|100] "C" Vector__XXX
 SG_ PICO_BMS_FB_temperature_battery_00_00_03  m3: 31|16@0- (0.1,0) [0|100] "C" Vector__XXX
 SG_ PICO_BMS_FB_temperature_battery_00_00_04  m4: 31|16@0- (0.1,0) [0|100] "C" Vector__XXX
 SG_ PICO_BMS_FB_temperature_battery_00_00_05  m5: 31|16@0- (0.1,0) [0|100] "C" Vector__XXX
 SG_ PICO_BMS_FB_temperature_battery_00_00_06  m6: 31|16@0- (0.1,0) [0|100] "C" Vector__XXX
 SG_ PICO_BMS_FB_temperature_battery_00_00_07  m7: 31|16@0- (0.1,0) [0|100] "C" Vector__XXX
 SG_ PICO_BMS_FB_temperature_battery_00_00_08  m8: 31|16@0- (0.1,0) [0|100] "C" Vector__XXX
 SG_ PICO_BMS_FB_temperature_battery_00_00_09  m9: 31|16@0- (0.1,0) [0|100] "C" Vector__XXX
 SG_ PICO_BMS_FB_temperature_battery_00_00_10  m10: 31|16@0- (0.1,0) [0|100] "C" Vector__XXX
 SG_ PICO_BMS_FB_temperature_battery_00_00_11  m11: 31|16@0- (0.1,0) [0|100] "C" Vector__XXX
 SG_ PICO_BMS_FB_temperature_battery_00_00_12  m12: 31|16@0- (0.1,0) [0|100] "C" Vector__XXX
 SG_ PICO_BMS_FB_temperature_battery_00_00_13  m13: 31|16@0- (0.1,0) [0|100] "C" Vector__XXX
 SG_ PICO_BMS_FB_temperature_battery_00_00_14  m14: 31|16@0- (0.1,0) [0|100] "C" Vector__XXX
 SG_ PICO_BMS_FB_temperature_battery_00_00_15  m15: 31|16@0- (0.1,0) [0|100] "C" Vector__XXX
 SG_ PICO_BMS_FB_temperature_battery_00_01_00  m256: 31|16@0- (0.1,0) [0|100] "C" Vector__XXX
 SG_ PICO_BMS_FB_temperature_battery_00_01_01  m257: 31|16@0- (0.1,0) [0|100] "C" Vector__XXX
 SG_ PICO_BMS_FB_temperature_battery_00_01_02  m258: 31|16@0- (0.1,0) [0|100] "C" Vector__XXX
 SG_ PICO_BMS_FB_temperature_battery_00_01_03  m259: 31|16@0- (0.1,0) [0|100] "C" Vector__XXX
 SG_ PICO_BMS_FB_temperature_battery_00_01_04  m260: 31|16@0- (0.1,0) [0|100] "C" Vector__XXX
 SG_ PICO_BMS_FB_temperature_battery_00_01_05  m261: 31|16@0- (0.1,0) [0|100] "C" Vector__XXX
 SG_ PICO_BMS_FB_temperature_battery_00_01_06  m262: 31|16@0- (0.1,0) [0|100] "C" Vector__XXX
 SG_ PICO_BMS_FB_temperature_battery_00_01_07  m263: 31|16@0- (0.1,0) [0|100] "C" Vector__XXX
 SG_ PICO_BMS_FB_temperature_battery_00_01_08  m264: 31|16@0- (0.1,0) [0|100] "C" Vector__XXX
 SG_ PICO_BMS_FB_temperature_battery_00_01_09  m265: 31|16@0- (0.1,0) [0|100] "C" Vector__XXX
 SG_ PICO_BMS_FB_temperature_battery_00_01_10  m266: 31|16@0- (0.1,0) [0|100] "C" Vector__XXX
 SG_ PICO_BMS_FB_temperature_battery_00_01_11  m267: 31|16@0- (0.1,0) [0|100] "C" Vector__XXX
 SG_ PICO_BMS_FB_temperature_battery_00_01_12  m268: 31|16@0- (0.1,0) [0|100] "C" Vector__XXX
 SG_ PICO_BMS_FB_temperature_battery_00_01_13  m269: 31|16@0- (0.1,0) [0|100] "C" Vector__XXX
 SG_ PICO_BMS_FB_temperature_battery_00_01_14  m270: 31|16@0- (0.1,0) [0|100] "C" Vector__XXX
 SG_ PICO_BMS_FB_temperature_battery_00_01_15  m271: 31|16@0- (0.1,0) [0|100] "C" Vector__XXX
 SG_ PICO_BMS_FB_temperature_battery_00_02_00  m512: 31|16@0- (0.1,0) [0|100] "C" Vector__XXX
 SG_ PICO_BMS_FB_temperature_battery_00_02_01  m513: 31|16@0- (0.1,0) [0|100] "C" Vector__XXX
 SG_ PICO_BMS_FB_temperature_battery_00_02_02  m514: 31|16@0- (0.1,0) [0|100] "C" Vector__XXX
 SG_ PICO_BMS_FB_temperature_battery_00_02_03  m515: 31|16@0- (0.1,0) [0|100] "C" Vector__XXX
 SG_ PICO_BMS_FB_temperature_battery_00_02_04  m516: 31|16@0- (0.1,0) [0|100] "C" Vector__XXX
 SG_ PICO_BMS_FB_temperature_battery_00_02_05  m517: 31|16@0- (0.1,0) [0|100] "C" Vector__XXX
 SG_ PICO_BMS_FB_temperature_battery_00_02_06  m518: 31|16@0- (0.1,0) [0|100] "C" Vector__XXX
 SG_ PICO_BMS_FB_temperature_battery_00_02_07  m519: 31|16@0- (0.1,0) [0|100] "C" Vector__XXX
 SG_ PICO_BMS_FB_temperature_battery_00_02_08  m520: 31|16@0- (0.1,0) [0|100] "C" Vector__XXX
 SG_ PICO_BMS_FB_temperature_battery_00_02_09  m521: 31|16@0- (0.1,0) [0|100] "C" Vector__XXX
 SG_ PICO_BMS_FB_temperature_battery_00_02_10  m522: 31|16@0- (0.1,0) [0|100] "C" Vector__XXX
 SG_ PICO_BMS_FB_temperature_battery_00_02_11  m523: 31|16@0- (0.1,0) [0|100] "C" Vector__XXX
 SG_ PICO_BMS_FB_temperature_battery_00_02_12  m524: 31|16@0- (0.1,0) [0|100] "C" Vector__XXX
 SG_ PICO_BMS_FB_temperature_battery_00_02_13  m525: 31|16@0- (0.1,0) [0|100] "C" Vector__XXX
 SG_ PICO_BMS_FB_temperature_battery_00_02_14  m526: 31|16@0- (0.1,0) [0|100] "C" Vector__XXX
 SG_ PICO_BMS_FB_temperature_battery_00_02_15  m527: 31|16@0- (0.1,0) [0|100] "C" Vector__XXX
 SG_ PICO_BMS_FB_temperature_battery_00_03_00  m768: 31|16@0- (0.1,0) [0|100] "C" Vector__XXX
 SG_ PICO_BMS_FB_temperature_battery_00_03_01  m769: 31|16@0- (0.1,0) [0|100] "C" Vector__XXX
 SG_ PICO_BMS_FB_temperature_battery_00_03_02  m770: 31|16@0- (0.1,0) [0|100] "C" Vector__XXX
 SG_ PICO_BMS_FB_temperature_battery_00_03_03  m771: 31|16@0- (0.1,0) [0|100] "C" Vector__XXX
 SG_ PICO_BMS_FB_temperature_battery_00_03_04  m772: 31|16@0- (0.1,0) [0|100] "C" Vector__XXX
 SG_ PICO_BMS_FB_temperature_battery_00_03_05  m773: 31|16@0- (0.1,0) [0|100] "C" Vector__XXX
 SG_ PICO_BMS_FB_temperature_battery_00_03_06  m774: 31|16@0- (0.1,0) [0|100] "C" Vector__XXX
 SG_ PICO_BMS_FB_temperature_battery_00_03_07  m775: 31|16@0- (0.1,0) [0|100] "C" Vector__XXX
 SG_ PICO_BMS_FB_temperature_battery_00_03_08  m776: 31|16@0- (0.1,0) [0|100] "C" Vector__XXX
 SG_ PICO_BMS_FB_temperature_battery_00_03_09  m777: 31|16@0- (0.1,0) [0|100] "C" Vector__XXX
 SG_ PICO_BMS_FB_temperature_battery_00_03_10  m778: 31|16@0- (0.1,0) [0|100] "C" Vector__XXX
 SG_ PICO_BMS_FB_temperature_battery_00_03_11  m779: 31|16@0- (0.1,0) [0|100] "C" Vector__XXX
 SG_ PICO_BMS_FB_temperature_battery_00_03_12  m780: 31|16@0- (0.1,0) [0|100] "C" Vector__XXX
 SG_ PICO_BMS_FB_temperature_battery_00_03_13  m781: 31|16@0- (0.1,0) [0|100] "C" Vector__XXX
 SG_ PICO_BMS_FB_temperature_battery_00_03_14  m782: 31|16@0- (0.1,0) [0|100] "C" Vector__XXX
 SG_ PICO_BMS_FB_temperature_battery_00_03_15  m783: 31|16@0- (0.1,0) [0|100] "C" Vector__XXX
 SG_ PICO_BMS_FB_temperature_battery_00_04_00  m1024: 31|16@0- (0.1,0) [0|100] "C" Vector__XXX
 SG_ PICO_BMS_FB_temperature_battery_00_04_01  m1025: 31|16@0- (0.1,0) [0|100] "C" Vector__XXX
 SG_ PICO_BMS_FB_temperature_battery_00_04_02  m1026: 31|16@0- (0.1,0) [0|100] "C" Vector__XXX
 SG_ PICO_BMS_FB_temperature_battery_00_04_03  m1027: 31|16@0- (0.1,0) [0|100] "C" Vector__XXX
 SG_ PICO_BMS_FB_temperature_battery_00_04_04  m1028: 31|16@0- (0.1,0) [0|100] "C" Vector__XXX
 SG_ PICO_BMS_FB_temperature_battery_00_04_05  m1029: 31|16@0- (0.1,0) [0|100] "C" Vector__XXX
 SG_ PICO_BMS_FB_temperature_battery_00_04_06  m1030: 31|16@0- (0.1,0) [0|100] "C" Vector__XXX
 SG_ PICO_BMS_FB_temperature_battery_00_04_07  m1031: 31|16@0- (0.1,0) [0|100] "C" Vector__XXX
 SG_ PICO_BMS_FB_temperature_battery_00_04_08  m1032: 31|16@0- (0.1,0) [0|100] "C" Vector__XXX
 SG_ PICO_BMS_FB_temperature_battery_00_04_09  m1033: 31|16@0- (0.1,0) [0|100] "C" Vector__XXX
 SG_ PICO_BMS_FB_temperature_battery_00_04_10  m1034: 31|16@0- (0.1,0) [0|100] "C" Vector__XXX
 SG_ PICO_BMS_FB_temperature_battery_00_04_11  m1035: 31|16@0- (0.1,0) [0|100] "C" Vector__XXX
 SG_ PICO_BMS_FB_temperature_battery_00_04_12  m1036: 31|16@0- (0.1,0) [0|100] "C" Vector__XXX
 SG_ PICO_BMS_FB_temperature_battery_00_04_13  m1037: 31|16@0- (0.1,0) [0|100] "C" Vector__XXX
 SG_ PICO_BMS_FB_temperature_battery_00_04_14  m1038: 31|16@0- (0.1,0) [0|100] "C" Vector__XXX
 SG_ PICO_BMS_FB_temperature_battery_00_04_15  m1039: 31|16@0- (0.1,0) [0|100] "C" Vector__XXX
 SG_ PICO_BMS_FB_temperature_battery_00_05_00  m1280: 31|16@0- (0.1,0) [0|100] "C" Vector__XXX
 SG_ PICO_BMS_FB_temperature_battery_00_05_01  m1281: 31|16@0- (0.1,0) [0|100] "C" Vector__XXX
 SG_ PICO_BMS_FB_temperature_battery_00_05_02  m1282: 31|16@0- (0.1,0) [0|100] "C" Vector__XXX
 SG_ PICO_BMS_FB_temperature_battery_00_05_03  m1283: 31|16@0- (0.1,0) [0|100] "C" Vector__XXX
 SG_ PICO_BMS_FB_temperature_battery_00_05_04  m1284: 31|16@0- (0.1,0) [0|100] "C" Vector__XXX
 SG_ PICO_BMS_FB_temperature_battery_00_05_05  m1285: 31|16@0- (0.1,0) [0|100] "C" Vector__XXX
 SG_ PICO_BMS_FB_temperature_battery_00_05_06  m1286: 31|16@0- (0.1,0) [0|100] "C" Vector__XXX
 SG_ PICO_BMS_FB_temperature_battery_00_05_07  m1287: 31|16@0- (0.1,0) [0|100] "C" Vector__XXX
 SG_ PICO_BMS_FB_temperature_battery_00_05_08  m1288: 31|16@0- (0.1,0) [0|100] "C" Vector__XXX
 SG_ PICO_BMS_FB_temperature_battery_00_05_09  m1289: 31|16@0- (0.1,0) [0|100] "C" Vector__XXX
 SG_ PICO_BMS_FB_temperature_battery_00_05_10  m1290: 31|16@0- (0.1,0) [0|100] "C" Vector__XXX
 SG_ PICO_BMS_FB_temperature_battery_00_05_11  m1291: 31|16@0- (0.1,0) [0|100] "C" Vector__XXX
 SG_ PICO_BMS_FB_temperature_battery_00_05_12  m1292: 31|16@0- (0.1,0) [0|100] "C" Vector__XXX
 SG_ PICO_BMS_FB_temperature_battery_00_05_13  m1293: 31|16@0- (0.1,0) [0|100] "C" Vector__XXX
 SG_ PICO_BMS_FB_temperature_battery_00_05_14  m1294: 31|16@0- (0.1,0) [0|100] "C" Vector__XXX
 SG_ PICO_BMS_FB_temperature_battery_00_05_15  m1295: 31|16@0- (0.1,0) [0|100] "C" Vector__XXX
 SG_ PICO_BMS_FB_temperature_battery_00_06_00  m1536: 31|16@0- (0.1,0) [0|100] "C" Vector__XXX
 SG_ PICO_BMS_FB_temperature_battery_00_06_01  m1537: 31|16@0- (0.1,0) [0|100] "C" Vector__XXX
 SG_ PICO_BMS_FB_temperature_battery_00_06_02  m1538: 31|16@0- (0.1,0) [0|100] "C" Vector__XXX
 SG_ PICO_BMS_FB_temperature_battery_00_06_03  m1539: 31|16@0- (0.1,0) [0|100] "C" Vector__XXX
 SG_ PICO_BMS_FB_temperature_battery_00_06_04  m1540: 31|16@0- (0.1,0) [0|100] "C" Vector__XXX
 SG_ PICO_BMS_FB_temperature_battery_00_06_05  m1541: 31|16@0- (0.1,0) [0|100] "C" Vector__XXX
 SG_ PICO_BMS_FB_temperature_battery_00_06_06  m1542: 31|16@0- (0.1,0) [0|100] "C" Vector__XXX
 SG_ PICO_BMS_FB_temperature_battery_00_06_07  m1543: 31|16@0- (0.1,0) [0|100] "C" Vector__XXX
 SG_ PICO_BMS_FB_temperature_battery_00_06_08  m1544: 31|16@0- (0.1,0) [0|100] "C" Vector__XXX
 SG_ PICO_BMS_FB_temperature_battery_00_06_09  m1545: 31|16@0- (0.1,0) [0|100] "C" Vector__XXX
 SG_ PICO_BMS_FB_temperature_battery_00_06_10  m1546: 31|16@0- (0.1,0) [0|100] "C" Vector__XXX
 SG_ PICO_BMS_FB_temperature_battery_00_06_11  m1547: 31|16@0- (0.1,0) [0|100] "C" Vector__XXX
 SG_ PICO_BMS_FB_temperature_battery_00_06_12  m1548: 31|16@0- (0.1,0) [0|100] "C" Vector__XXX
 SG_ PICO_BMS_FB_temperature_battery_00_06_13  m1549: 31|16@0- (0.1,0) [0|100] "C" Vector__XXX
 SG_ PICO_BMS_FB_temperature_battery_00_06_14  m1550: 31|16@0- (0.1,0) [0|100] "C" Vector__XXX
 SG_ PICO_BMS_FB_temperature_battery_00_06_15  m1551: 31|16@0- (0.1,0) [0|100] "C" Vector__XXX
 SG_ PICO_BMS_FB_temperature_battery_00_07_00  m1792: 31|16@0- (0.1,0) [0|100] "C" Vector__XXX
 SG_ PICO_BMS_FB_temperature_battery_00_07_01  m1793: 31|16@0- (0.1,0) [0|100] "C" Vector__XXX
 SG_ PICO_BMS_FB_temperature_battery_00_07_02  m1794: 31|16@0- (0.1,0) [0|100] "C" Vector__XXX
 SG_ PICO_BMS_FB_temperature_battery_00_07_03  m1795: 31|16@0- (0.1,0) [0|100] "C" Vector__XXX
 SG_ PICO_BMS_FB_temperature_battery_00_07_04  m1796: 31|16@0- (0.1,0) [0|100] "C" Vector__XXX
 SG_ PICO_BMS_FB_temperature_battery_00_07_05  m1797: 31|16@0- (0.1,0) [0|100] "C" Vector__XXX
 SG_ PICO_BMS_FB_temperature_battery_00_07_06  m1798: 31|16@0- (0.1,0) [0|100] "C" Vector__XXX
 SG_ PICO_BMS_FB_temperature_battery_00_07_07  m1799: 31|16@0- (0.1,0) [0|100] "C" Vector__XXX
 SG_ PICO_BMS_FB_temperature_battery_00_07_08  m1800: 31|16@0- (0.1,0) [0|100] "C" Vector__XXX
 SG_ PICO_BMS_FB_temperature_battery_00_07_09  m1801: 31|16@0- (0.1,0) [0|100] "C" Vector__XXX
 SG_ PICO_BMS_FB_temperature_battery_00_07_10  m1802: 31|16@0- (0.1,0) [0|100] "C" Vector__XXX
 SG_ PICO_BMS_FB_temperature_battery_00_07_11  m1803: 31|16@0- (0.1,0) [0|100] "C" Vector__XXX
 SG_ PICO_BMS_FB_temperature_battery_00_07_12  m1804: 31|16@0- (0.1,0) [0|100] "C" Vector__XXX
 SG_ PICO_BMS_FB_temperature_battery_00_07_13  m1805: 31|16@0- (0.1,0) [0|100] "C" Vector__XXX
 SG_ PICO_BMS_FB_temperature_battery_00_07_14  m1806: 31|16@0- (0.1,0) [0|100] "C" Vector__XXX
 SG_ PICO_BMS_FB_temperature_battery_00_07_15  m1807: 31|16@0- (0.1,0) [0|100] "C" Vector__XXX
 SG_ PICO_BMS_FB_temperature_battery_00_08_00  m2048: 31|16@0- (0.1,0) [0|100] "C" Vector__XXX
 SG_ PICO_BMS_FB_temperature_battery_00_08_01  m2049: 31|16@0- (0.1,0) [0|100] "C" Vector__XXX
 SG_ PICO_BMS_FB_temperature_battery_00_08_02  m2050: 31|16@0- (0.1,0) [0|100] "C" Vector__XXX
 SG_ PICO_BMS_FB_temperature_battery_00_08_03  m2051: 31|16@0- (0.1,0) [0|100] "C" Vector__XXX
 SG_ PICO_BMS_FB_temperature_battery_00_08_04  m2052: 31|16@0- (0.1,0) [0|100] "C" Vector__XXX
 SG_ PICO_BMS_FB_temperature_battery_00_08_05  m2053: 31|16@0- (0.1,0) [0|100] "C" Vector__XXX
 SG_ PICO_BMS_FB_temperature_battery_00_08_06  m2054: 31|16@0- (0.1,0) [0|100] "C" Vector__XXX
 SG_ PICO_BMS_FB_temperature_battery_00_08_07  m2055: 31|16@0- (0.1,0) [0|100] "C" Vector__XXX
 SG_ PICO_BMS_FB_temperature_battery_00_08_08  m2056: 31|16@0- (0.1,0) [0|100] "C" Vector__XXX
 SG_ PICO_BMS_FB_temperature_battery_00_08_09  m2057: 31|16@0- (0.1,0) [0|100] "C" Vector__XXX
 SG_ PICO_BMS_FB_temperature_battery_00_08_10  m2058: 31|16@0- (0.1,0) [0|100] "C" Vector__XXX
 SG_ PICO_BMS_FB_temperature_battery_00_08_11  m2059: 31|16@0- (0.1,0) [0|100] "C" Vector__XXX
 SG_ PICO_BMS_FB_temperature_battery_00_08_12  m2060: 31|16@0- (0.1,0) [0|100] "C" Vector__XXX
 SG_ PICO_BMS_FB_temperature_battery_00_08_13  m2061: 31|16@0- (0.1,0) [0|100] "C" Vector__XXX
 SG_ PICO_BMS_FB_temperature_battery_00_08_14  m2062: 31|16@0- (0.1,0) [0|100] "C" Vector__XXX
 SG_ PICO_BMS_FB_temperature_battery_00_08_15  m2063: 31|16@0- (0.1,0) [0|100] "C" Vector__XXX
 SG_ PICO_BMS_FB_temperature_battery_00_09_00  m2304: 31|16@0- (0.1,0) [0|100] "C" Vector__XXX
 SG_ PICO_BMS_FB_temperature_battery_00_09_01  m2305: 31|16@0- (0.1,0) [0|100] "C" Vector__XXX
 SG_ PICO_BMS_FB_temperature_battery_00_09_02  m2306: 31|16@0- (0.1,0) [0|100] "C" Vector__XXX
 SG_ PICO_BMS_FB_temperature_battery_00_09_03  m2307: 31|16@0- (0.1,0) [0|100] "C" Vector__XXX
 SG_ PICO_BMS_FB_temperature_battery_00_09_04  m2308: 31|16@0- (0.1,0) [0|100] "C" Vector__XXX
 SG_ PICO_BMS_FB_temperature_battery_00_09_05  m2309: 31|16@0- (0.1,0) [0|100] "C" Vector__XXX
 SG_ PICO_BMS_FB_temperature_battery_00_09_06  m2310: 31|16@0- (0.1,0) [0|100] "C" Vector__XXX
 SG_ PICO_BMS_FB_temperature_battery_00_09_07  m2311: 31|16@0- (0.1,0) [0|100] "C" Vector__XXX
 SG_ PICO_BMS_FB_temperature_battery_00_09_08  m2312: 31|16@0- (0.1,0) [0|100] "C" Vector__XXX
 SG_ PICO_BMS_FB_temperature_battery_00_09_09  m2313: 31|16@0- (0.1,0) [0|100] "C" Vector__XXX
 SG_ PICO_BMS_FB_temperature_battery_00_09_10  m2314: 31|16@0- (0.1,0) [0|100] "C" Vector__XXX
 SG_ PICO_BMS_FB_temperature_battery_00_09_11  m2315: 31|16@0- (0.1,0) [0|100] "C" Vector__XXX
 SG_ PICO_BMS_FB_temperature_battery_00_09_12  m2316: 31|16@0- (0.1,0) [0|100] "C" Vector__XXX
 SG_ PICO_BMS_FB_temperature_battery_00_09_13  m2317: 31|16@0- (0.1,0) [0|100] "C" Vector__XXX
 SG_ PICO_BMS_FB_temperature_battery_00_09_14  m2318: 31|16@0- (0.1,0) [0|100] "C" Vector__XXX
 SG_ PICO_BMS_FB_temperature_battery_00_09_15  m2319: 31|16@0- (0.1,0) [0|100] "C" Vector__XXX
 SG_ PICO_BMS_FB_temperature_battery_00_10_00  m2560: 31|16@0- (0.1,0) [0|100] "C" Vector__XXX
 SG_ PICO_BMS_FB_temperature_battery_00_10_01  m2561: 31|16@0- (0.1,0) [0|100] "C" Vector__XXX
 SG_ PICO_BMS_FB_temperature_battery_00_10_02  m2562: 31|16@0- (0.1,0) [0|100] "C" Vector__XXX
 SG_ PICO_BMS_FB_temperature_battery_00_10_03  m2563: 31|16@0- (0.1,0) [0|100] "C" Vector__XXX
 SG_ PICO_BMS_FB_temperature_battery_00_10_04  m2564: 31|16@0- (0.1,0) [0|100] "C" Vector__XXX
 SG_ PICO_BMS_FB_temperature_battery_00_10_05  m2565: 31|16@0- (0.1,0) [0|100] "C" Vector__XXX
 SG_ PICO_BMS_FB_temperature_battery_00_10_06  m2566: 31|16@0- (0.1,0) [0|100] "C" Vector__XXX
 SG_ PICO_BMS_FB_temperature_battery_00_10_07  m2567: 31|16@0- (0.1,0) [0|100] "C" Vector__XXX
 SG_ PICO_BMS_FB_temperature_battery_00_10_08  m2568: 31|16@0- (0.1,0) [0|100] "C" Vector__XXX
 SG_ PICO_BMS_FB_temperature_battery_00_10_09  m2569: 31|16@0- (0.1,0) [0|100] "C" Vector__XXX
 SG_ PICO_BMS_FB_temperature_battery_00_10_10  m2570: 31|16@0- (0.1,0) [0|100] "C" Vector__XXX
 SG_ PICO_BMS_FB_temperature_battery_00_10_11  m2571: 31|16@0- (0.1,0) [0|100] "C" Vector__XXX
 SG_ PICO_BMS_FB_temperature_battery_00_10_12  m2572: 31|16@0- (0.1,0) [0|100] "C" Vector__XXX
 SG_ PICO_BMS_FB_temperature_battery_00_10_13  m2573: 31|16@0- (0.1,0) [0|100] "C" Vector__XXX
 SG_ PICO_BMS_FB_temperature_battery_00_10_14  m2574: 31|16@0- (0.1,0) [0|100] "C" Vector__XXX
 SG_ PICO_BMS_FB_temperature_battery_00_10_15  m2575: 31|16@0- (0.1,0) [0|100] "C" Vector__XXX
 SG_ PICO_BMS_FB_temperature_battery_00_11_00  m2816: 31|16@0- (0.1,0) [0|100] "C" Vector__XXX
 SG_ PICO_BMS_FB_temperature_battery_00_11_01  m2817: 31|16@0- (0.1,0) [0|100] "C" Vector__XXX
 SG_ PICO_BMS_FB_temperature_battery_00_11_02  m2818: 31|16@0- (0.1,0) [0|100] "C" Vector__XXX
 SG_ PICO_BMS_FB_temperature_battery_00_11_03  m2819: 31|16@0- (0.1,0) [0|100] "C" Vector__XXX
 SG_ PICO_BMS_FB_temperature_battery_00_11_04  m2820: 31|16@0- (0.1,0) [0|100] "C" Vector__XXX
 SG_ PICO_BMS_FB_temperature_battery_00_11_05  m2821: 31|16@0- (0.1,0) [0|100] "C" Vector__XXX
 SG_ PICO_BMS_FB_temperature_battery_00_11_06  m2822: 31|16@0- (0.1,0) [0|100] "C" Vector__XXX
 SG_ PICO_BMS_FB_temperature_battery_00_11_07  m2823: 31|16@0- (0.1,0) [0|100] "C" Vector__XXX
 SG_ PICO_BMS_FB_temperature_battery_00_11_08  m2824: 31|16@0- (0.1,0) [0|100] "C" Vector__XXX
 SG_ PICO_BMS_FB_temperature_battery_00_11_09  m2825: 31|16@0- (0.1,0) [0|100] "C" Vector__XXX
 SG_ PICO_BMS_FB_temperature_battery_00_11_10  m2826: 31|16@0- (0.1,0) [0|100] "C" Vector__XXX
 SG_ PICO_BMS_FB_temperature_battery_00_11_11  m2827: 31|16@0- (0.1,0) [0|100] "C" Vector__XXX
 SG_ PICO_BMS_FB_temperature_battery_00_11_12  m2828: 31|16@0- (0.1,0) [0|100] "C" Vector__XXX
 SG_ PICO_BMS_FB_temperature_battery_00_11_13  m2829: 31|16@0- (0.1,0) [0|100] "C" Vector__XXX
 SG_ PICO_BMS_FB_temperature_battery_00_11_14  m2830: 31|16@0- (0.1,0) [0|100] "C" Vector__XXX
 SG_ PICO_BMS_FB_temperature_battery_00_11_15  m2831: 31|16@0- (0.1,0) [0|100] "C" Vector__XXX
 SG_ PICO_BMS_FB_temperature_battery_00_12_00  m3072: 31|16@0- (0.1,0) [0|100] "C" Vector__XXX
 SG_ PICO_BMS_FB_temperature_battery_00_12_01  m3073: 31|16@0- (0.1,0) [0|100] "C" Vector__XXX
 SG_ PICO_BMS_FB_temperature_battery_00_12_02  m3074: 31|16@0- (0.1,0) [0|100] "C" Vector__XXX
 SG_ PICO_BMS_FB_temperature_battery_00_12_03  m3075: 31|16@0- (0.1,0) [0|100] "C" Vector__XXX
 SG_ PICO_BMS_FB_temperature_battery_00_12_04  m3076: 31|16@0- (0.1,0) [0|100] "C" Vector__XXX
 SG_ PICO_BMS_FB_temperature_battery_00_12_05  m3077: 31|16@0- (0.1,0) [0|100] "C" Vector__XXX
 SG_ PICO_BMS_FB_temperature_battery_00_12_06  m3078: 31|16@0- (0.1,0) [0|100] "C" Vector__XXX
 SG_ PICO_BMS_FB_temperature_battery_00_12_07  m3079: 31|16@0- (0.1,0) [0|100] "C" Vector__XXX
 SG_ PICO_BMS_FB_temperature_battery_00_12_08  m3080: 31|16@0- (0.1,0) [0|100] "C" Vector__XXX
 SG_ PICO_BMS_FB_temperature_battery_00_12_09  m3081: 31|16@0- (0.1,0) [0|100] "C" Vector__XXX
 SG_ PICO_BMS_FB_temperature_battery_00_12_10  m3082: 31|16@0- (0.1,0) [0|100] "C" Vector__XXX
 SG_ PICO_BMS_FB_temperature_battery_00_12_11  m3083: 31|16@0- (0.1,0) [0|100] "C" Vector__XXX
 SG_ PICO_BMS_FB_temperature_battery_00_12_12  m3084: 31|16@0- (0.1,0) [0|100] "C" Vector__XXX
 SG_ PICO_BMS_FB_temperature_battery_00_12_13  m3085: 31|16@0- (0.1,0) [0|100] "C" Vector__XXX
 SG_ PICO_BMS_FB_temperature_battery_00_12_14  m3086: 31|16@0- (0.1,0) [0|100] "C" Vector__XXX
 SG_ PICO_BMS_FB_temperature_battery_00_12_15  m3087: 31|16@0- (0.1,0) [0|100] "C" Vector__XXX
 SG_ PICO_BMS_FB_temperature_battery_00_13_00  m3328: 31|16@0- (0.1,0) [0|100] "C" Vector__XXX
 SG_ PICO_BMS_FB_temperature_battery_00_13_01  m3329: 31|16@0- (0.1,0) [0|100] "C" Vector__XXX
 SG_ PICO_BMS_FB_temperature_battery_00_13_02  m3330: 31|16@0- (0.1,0) [0|100] "C" Vector__XXX
 SG_ PICO_BMS_FB_temperature_battery_00_13_03  m3331: 31|16@0- (0.1,0) [0|100] "C" Vector__XXX
 SG_ PICO_BMS_FB_temperature_battery_00_13_04  m3332: 31|16@0- (0.1,0) [0|100] "C" Vector__XXX
 SG_ PICO_BMS_FB_temperature_battery_00_13_05  m3333: 31|16@0- (0.1,0) [0|100] "C" Vector__XXX
 SG_ PICO_BMS_FB_temperature_battery_00_13_06  m3334: 31|16@0- (0.1,0) [0|100] "C" Vector__XXX
 SG_ PICO_BMS_FB_temperature_battery_00_13_07  m3335: 31|16@0- (0.1,0) [0|100] "C" Vector__XXX
 SG_ PICO_BMS_FB_temperature_battery_00_13_08  m3336: 31|16@0- (0.1,0) [0|100] "C" Vector__XXX
 SG_ PICO_BMS_FB_temperature_battery_00_13_09  m3337: 31|16@0- (0.1,0) [0|100] "C" Vector__XXX
 SG_ PICO_BMS_FB_temperature_battery_00_13_10  m3338: 31|16@0- (0.1,0) [0|100] "C" Vector__XXX
 SG_ PICO_BMS_FB_temperature_battery_00_13_11  m3339: 31|16@0- (0.1,0) [0|100] "C" Vector__XXX
 SG_ PICO_BMS_FB_temperature_battery_00_13_12  m3340: 31|16@0- (0.1,0) [0|100] "C" Vector__XXX
 SG_ PICO_BMS_FB_temperature_battery_00_13_13  m3341: 31|16@0- (0.1,0) [0|100] "C" Vector__XXX
 SG_ PICO_BMS_FB_temperature_battery_00_13_14  m3342: 31|16@0- (0.1,0) [0|100] "C" Vector__XXX
 SG_ PICO_BMS_FB_temperature_battery_00_13_15  m3343: 31|16@0- (0.1,0) [0|100] "C" Vector__XXX
 SG_ PICO_BMS_FB_temperature_battery_00_14_00  m3584: 31|16@0- (0.1,0) [0|100] "C" Vector__XXX
 SG_ PICO_BMS_FB_temperature_battery_00_14_01  m3585: 31|16@0- (0.1,0) [0|100] "C" Vector__XXX
 SG_ PICO_BMS_FB_temperature_battery_00_14_02  m3586: 31|16@0- (0.1,0) [0|100] "C" Vector__XXX
 SG_ PICO_BMS_FB_temperature_battery_00_14_03  m3587: 31|16@0- (0.1,0) [0|100] "C" Vector__XXX
 SG_ PICO_BMS_FB_temperature_battery_00_14_04  m3588: 31|16@0- (0.1,0) [0|100] "C" Vector__XXX
 SG_ PICO_BMS_FB_temperature_battery_00_14_05  m3589: 31|16@0- (0.1,0) [0|100] "C" Vector__XXX
 SG_ PICO_BMS_FB_temperature_battery_00_14_06  m3590: 31|16@0- (0.1,0) [0|100] "C" Vector__XXX
 SG_ PICO_BMS_FB_temperature_battery_00_14_07  m3591: 31|16@0- (0.1,0) [0|100] "C" Vector__XXX
 SG_ PICO_BMS_FB_temperature_battery_00_14_08  m3592: 31|16@0- (0.1,0) [0|100] "C" Vector__XXX
 SG_ PICO_BMS_FB_temperature_battery_00_14_09  m3593: 31|16@0- (0.1,0) [0|100] "C" Vector__XXX
 SG_ PICO_BMS_FB_temperature_battery_00_14_10  m3594: 31|16@0- (0.1,0) [0|100] "C" Vector__XXX
 SG_ PICO_BMS_FB_temperature_battery_00_14_11  m3595: 31|16@0- (0.1,0) [0|100] "C" Vector__XXX
 SG_ PICO_BMS_FB_temperature_battery_00_14_12  m3596: 31|16@0- (0.1,0) [0|100] "C" Vector__XXX
 SG_ PICO_BMS_FB_temperature_battery_00_14_13  m3597: 31|16@0- (0.1,0) [0|100] "C" Vector__XXX
 SG_ PICO_BMS_FB_temperature_battery_00_14_14  m3598: 31|16@0- (0.1,0) [0|100] "C" Vector__XXX
 SG_ PICO_BMS_FB_temperature_battery_00_14_15  m3599: 31|16@0- (0.1,0) [0|100] "C" Vector__XXX
 SG_ PICO_BMS_FB_temperature_battery_00_15_00  m3840: 31|16@0- (0.1,0) [0|100] "C" Vector__XXX
 SG_ PICO_BMS_FB_temperature_battery_00_15_01  m3841: 31|16@0- (0.1,0) [0|100] "C" Vector__XXX
 SG_ PICO_BMS_FB_temperature_battery_00_15_02  m3842: 31|16@0- (0.1,0) [0|100] "C" Vector__XXX
 SG_ PICO_BMS_FB_temperature_battery_00_15_03  m3843: 31|16@0- (0.1,0) [0|100] "C" Vector__XXX
 SG_ PICO_BMS_FB_temperature_battery_00_15_04  m3844: 31|16@0- (0.1,0) [0|100] "C" Vector__XXX
 SG_ PICO_BMS_FB_temperature_battery_00_15_05  m3845: 31|16@0- (0.1,0) [0|100] "C" Vector__XXX
 SG_ PICO_BMS_FB_temperature_battery_00_15_06  m3846: 31|16@0- (0.1,0) [0|100] "C" Vector__XXX
 SG_ PICO_BMS_FB_temperature_battery_00_15_07  m3847: 31|16@0- (0.1,0) [0|100] "C" Vector__XXX
 SG_ PICO_BMS_FB_temperature_battery_00_15_08  m3848: 31|16@0- (0.1,0) [0|100] "C" Vector__XXX
 SG_ PICO_BMS_FB_temperature_battery_00_15_09  m3849: 31|16@0- (0.1,0) [0|100] "C" Vector__XXX
 SG_ PICO_BMS_FB_temperature_battery_00_15_10  m3850: 31|16@0- (0.1,0) [0|100] "C" Vector__XXX
 SG_ PICO_BMS_FB_temperature_battery_00_15_11  m3851: 31|16@0- (0.1,0) [0|100] "C" Vector__XXX
 SG_ PICO_BMS_FB_temperature_battery_00_15_12  m3852: 31|16@0- (0.1,0) [0|100] "C" Vector__XXX
 SG_ PICO_BMS_FB_temperature_battery_00_15_13  m3853: 31|16@0- (0.1,0) [0|100] "C" Vector__XXX
 SG_ PICO_BMS_FB_temperature_battery_00_15_14  m3854: 31|16@0- (0.1,0) [0|100] "C" Vector__XXX
 SG_ PICO_BMS_FB_temperature_battery_00_15_15  m3855: 31|16@0- (0.1,0) [0|100] "C" Vector__XXX
 SG_ PICO_BMS_FB_temperature_battery_01_00_00  m65536: 31|16@0- (0.1,0) [0|100] "C" Vector__XXX
 SG_ PICO_BMS_FB_temperature_battery_01_00_01  m65537: 31|16@0- (0.1,0) [0|100] "C" Vector__XXX
 SG_ PICO_BMS_FB_temperature_battery_01_00_02  m65538: 31|16@0- (0.1,0) [0|100] "C" Vector__XXX
 SG_ PICO_BMS_FB_temperature_battery_01_00_03  m65539: 31|16@0- (0.1,0) [0|100] "C" Vector__XXX
 SG_ PICO_BMS_FB_temperature_battery_01_00_04  m65540: 31|16@0- (0.1,0) [0|100] "C" Vector__XXX
 SG_ PICO_BMS_FB_temperature_battery_01_00_05  m65541: 31|16@0- (0.1,0) [0|100] "C" Vector__XXX
 SG_ PICO_BMS_FB_temperature_battery_01_00_06  m65542: 31|16@0- (0.1,0) [0|100] "C" Vector__XXX
 SG_ PICO_BMS_FB_temperature_battery_01_00_07  m65543: 31|16@0- (0.1,0) [0|100] "C" Vector__XXX
 SG_ PICO_BMS_FB_temperature_battery_01_00_08  m65544: 31|16@0- (0.1,0) [0|100] "C" Vector__XXX
 SG_ PICO_BMS_FB_temperature_battery_01_00_09  m65545: 31|16@0- (0.1,0) [0|100] "C" Vector__XXX
 SG_ PICO_BMS_FB_temperature_battery_01_00_10  m65546: 31|16@0- (0.1,0) [0|100] "C" Vector__XXX
 SG_ PICO_BMS_FB_temperature_battery_01_00_11  m65547: 31|16@0- (0.1,0) [0|100] "C" Vector__XXX
 SG_ PICO_BMS_FB_temperature_battery_01_00_12  m65548: 31|16@0- (0.1,0) [0|100] "C" Vector__XXX
 SG_ PICO_BMS_FB_temperature_battery_01_00_13  m65549: 31|16@0- (0.1,0) [0|100] "C" Vector__XXX
 SG_ PICO_BMS_FB_temperature_battery_01_00_14  m65550: 31|16@0- (0.1,0) [0|100] "C" Vector__XXX
 SG_ PICO_BMS_FB_temperature_battery_01_00_15  m65551: 31|16@0- (0.1,0) [0|100] "C" Vector__XXX
 SG_ PICO_BMS_FB_temperature_battery_01_01_00  m65792: 31|16@0- (0.1,0) [0|100] "C" Vector__XXX
 SG_ PICO_BMS_FB_temperature_battery_01_01_01  m65793: 31|16@0- (0.1,0) [0|100] "C" Vector__XXX
 SG_ PICO_BMS_FB_temperature_battery_01_01_02  m65794: 31|16@0- (0.1,0) [0|100] "C" Vector__XXX
 SG_ PICO_BMS_FB_temperature_battery_01_01_03  m65795: 31|16@0- (0.1,0) [0|100] "C" Vector__XXX
 SG_ PICO_BMS_FB_temperature_battery_01_01_04  m65796: 31|16@0- (0.1,0) [0|100] "C" Vector__XXX
 SG_ PICO_BMS_FB_temperature_battery_01_01_05  m65797: 31|16@0- (0.1,0) [0|100] "C" Vector__XXX
 SG_ PICO_BMS_FB_temperature_battery_01_01_06  m65798: 31|16@0- (0.1,0) [0|100] "C" Vector__XXX
 SG_ PICO_BMS_FB_temperature_battery_01_01_07  m65799: 31|16@0- (0.1,0) [0|100] "C" Vector__XXX
 SG_ PICO_BMS_FB_temperature_battery_01_01_08  m65800: 31|16@0- (0.1,0) [0|100] "C" Vector__XXX
 SG_ PICO_BMS_FB_temperature_battery_01_01_09  m65801: 31|16@0- (0.1,0) [0|100] "C" Vector__XXX
 SG_ PICO_BMS_FB_temperature_battery_01_01_10  m65802: 31|16@0- (0.1,0) [0|100] "C" Vector__XXX
 SG_ PICO_BMS_FB_temperature_battery_01_01_11  m65803: 31|16@0- (0.1,0) [0|100] "C" Vector__XXX
 SG_ PICO_BMS_FB_temperature_battery_01_01_12  m65804: 31|16@0- (0.1,0) [0|100] "C" Vector__XXX
 SG_ PICO_BMS_FB_temperature_battery_01_01_13  m65805: 31|16@0- (0.1,0) [0|100] "C" Vector__XXX
 SG_ PICO_BMS_FB_temperature_battery_01_01_14  m65806: 31|16@0- (0.1,0) [0|100] "C" Vector__XXX
 SG_ PICO_BMS_FB_temperature_battery_01_01_15  m65807: 31|16@0- (0.1,0) [0|100] "C" Vector__XXX
 SG_ PICO_BMS_FB_temperature_battery_01_02_00  m66048: 31|16@0- (0.1,0) [0|100] "C" Vector__XXX
 SG_ PICO_BMS_FB_temperature_battery_01_02_01  m66049: 31|16@0- (0.1,0) [0|100] "C" Vector__XXX
 SG_ PICO_BMS_FB_temperature_battery_01_02_02  m66050: 31|16@0- (0.1,0) [0|100] "C" Vector__XXX
 SG_ PICO_BMS_FB_temperature_battery_01_02_03  m66051: 31|16@0- (0.1,0) [0|100] "C" Vector__XXX
 SG_ PICO_BMS_FB_temperature_battery_01_02_04  m66052: 31|16@0- (0.1,0) [0|100] "C" Vector__XXX
 SG_ PICO_BMS_FB_temperature_battery_01_02_05  m66053: 31|16@0- (0.1,0) [0|100] "C" Vector__XXX
 SG_ PICO_BMS_FB_temperature_battery_01_02_06  m66054: 31|16@0- (0.1,0) [0|100] "C" Vector__XXX
 SG_ PICO_BMS_FB_temperature_battery_01_02_07  m66055: 31|16@0- (0.1,0) [0|100] "C" Vector__XXX
 SG_ PICO_BMS_FB_temperature_battery_01_02_08  m66056: 31|16@0- (0.1,0) [0|100] "C" Vector__XXX
 SG_ PICO_BMS_FB_temperature_battery_01_02_09  m66057: 31|16@0- (0.1,0) [0|100] "C" Vector__XXX
 SG_ PICO_BMS_FB_temperature_battery_01_02_10  m66058: 31|16@0- (0.1,0) [0|100] "C" Vector__XXX
 SG_ PICO_BMS_FB_temperature_battery_01_02_11  m66059: 31|16@0- (0.1,0) [0|100] "C" Vector__XXX
 SG_ PICO_BMS_FB_temperature_battery_01_02_12  m66060: 31|16@0- (0.1,0) [0|100] "C" Vector__XXX
 SG_ PICO_BMS_FB_temperature_battery_01_02_13  m66061: 31|16@0- (0.1,0) [0|100] "C" Vector__XXX
 SG_ PICO_BMS_FB_temperature_battery_01_02_14  m66062: 31|16@0- (0.1,0) [0|100] "C" Vector__XXX
 SG_ PICO_BMS_FB_temperature_battery_01_02_15  m66063: 31|16@0- (0.1,0) [0|100] "C" Vector__XXX
 SG_ PICO_BMS_FB_temperature_battery_01_03_00  m66304: 31|16@0- (0.1,0) [0|100] "C" Vector__XXX
 SG_ PICO_BMS_FB_temperature_battery_01_03_01  m66305: 31|16@0- (0.1,0) [0|100] "C" Vector__XXX
 SG_ PICO_BMS_FB_temperature_battery_01_03_02  m66306: 31|16@0- (0.1,0) [0|100] "C" Vector__XXX
 SG_ PICO_BMS_FB_temperature_battery_01_03_03  m66307: 31|16@0- (0.1,0) [0|100] "C" Vector__XXX
 SG_ PICO_BMS_FB_temperature_battery_01_03_04  m66308: 31|16@0- (0.1,0) [0|100] "C" Vector__XXX
 SG_ PICO_BMS_FB_temperature_battery_01_03_05  m66309: 31|16@0- (0.1,0) [0|100] "C" Vector__XXX
 SG_ PICO_BMS_FB_temperature_battery_01_03_06  m66310: 31|16@0- (0.1,0) [0|100] "C" Vector__XXX
 SG_ PICO_BMS_FB_temperature_battery_01_03_07  m66311: 31|16@0- (0.1,0) [0|100] "C" Vector__XXX
 SG_ PICO_BMS_FB_temperature_battery_01_03_08  m66312: 31|16@0- (0.1,0) [0|100] "C" Vector__XXX
 SG_ PICO_BMS_FB_temperature_battery_01_03_09  m66313: 31|16@0- (0.1,0) [0|100] "C" Vector__XXX
 SG_ PICO_BMS_FB_temperature_battery_01_03_10  m66314: 31|16@0- (0.1,0) [0|100] "C" Vector__XXX
 SG_ PICO_BMS_FB_temperature_battery_01_03_11  m66315: 31|16@0- (0.1,0) [0|100] "C" Vector__XXX
 SG_ PICO_BMS_FB_temperature_battery_01_03_12  m66316: 31|16@0- (0.1,0) [0|100] "C" Vector__XXX
 SG_ PICO_BMS_FB_temperature_battery_01_03_13  m66317: 31|16@0- (0.1,0) [0|100] "C" Vector__XXX
 SG_ PICO_BMS_FB_temperature_battery_01_03_14  m66318: 31|16@0- (0.1,0) [0|100] "C" Vector__XXX
 SG_ PICO_BMS_FB_temperature_battery_01_03_15  m66319: 31|16@0- (0.1,0) [0|100] "C" Vector__XXX
 SG_ PICO_BMS_FB_temperature_battery_01_04_00  m66560: 31|16@0- (0.1,0) [0|100] "C" Vector__XXX
 SG_ PICO_BMS_FB_temperature_battery_01_04_01  m66561: 31|16@0- (0.1,0) [0|100] "C" Vector__XXX
 SG_ PICO_BMS_FB_temperature_battery_01_04_02  m66562: 31|16@0- (0.1,0) [0|100] "C" Vector__XXX
 SG_ PICO_BMS_FB_temperature_battery_01_04_03  m66563: 31|16@0- (0.1,0) [0|100] "C" Vector__XXX
 SG_ PICO_BMS_FB_temperature_battery_01_04_04  m66564: 31|16@0- (0.1,0) [0|100] "C" Vector__XXX
 SG_ PICO_BMS_FB_temperature_battery_01_04_05  m66565: 31|16@0- (0.1,0) [0|100] "C" Vector__XXX
 SG_ PICO_BMS_FB_temperature_battery_01_04_06  m66566: 31|16@0- (0.1,0) [0|100] "C" Vector__XXX
 SG_ PICO_BMS_FB_temperature_battery_01_04_07  m66567: 31|16@0- (0.1,0) [0|100] "C" Vector__XXX
 SG_ PICO_BMS_FB_temperature_battery_01_04_08  m66568: 31|16@0- (0.1,0) [0|100] "C" Vector__XXX
 SG_ PICO_BMS_FB_temperature_battery_01_04_09  m66569: 31|16@0- (0.1,0) [0|100] "C" Vector__XXX
 SG_ PICO_BMS_FB_temperature_battery_01_04_10  m66570: 31|16@0- (0.1,0) [0|100] "C" Vector__XXX
 SG_ PICO_BMS_FB_temperature_battery_01_04_11  m66571: 31|16@0- (0.1,0) [0|100] "C" Vector__XXX
 SG_ PICO_BMS_FB_temperature_battery_01_04_12  m66572: 31|16@0- (0.1,0) [0|100] "C" Vector__XXX
 SG_ PICO_BMS_FB_temperature_battery_01_04_13  m66573: 31|16@0- (0.1,0) [0|100] "C" Vector__XXX
 SG_ PICO_BMS_FB_temperature_battery_01_04_14  m66574: 31|16@0- (0.1,0) [0|100] "C" Vector__XXX
 SG_ PICO_BMS_FB_temperature_battery_01_04_15  m66575: 31|16@0- (0.1,0) [0|100] "C" Vector__XXX
 SG_ PICO_BMS_FB_temperature_battery_01_05_00  m66816: 31|16@0- (0.1,0) [0|100] "C" Vector__XXX
 SG_ PICO_BMS_FB_temperature_battery_01_05_01  m66817: 31|16@0- (0.1,0) [0|100] "C" Vector__XXX
 SG_ PICO_BMS_FB_temperature_battery_01_05_02  m66818: 31|16@0- (0.1,0) [0|100] "C" Vector__XXX
 SG_ PICO_BMS_FB_temperature_battery_01_05_03  m66819: 31|16@0- (0.1,0) [0|100] "C" Vector__XXX
 SG_ PICO_BMS_FB_temperature_battery_01_05_04  m66820: 31|16@0- (0.1,0) [0|100] "C" Vector__XXX
 SG_ PICO_BMS_FB_temperature_battery_01_05_05  m66821: 31|16@0- (0.1,0) [0|100] "C" Vector__XXX
 SG_ PICO_BMS_FB_temperature_battery_01_05_06  m66822: 31|16@0- (0.1,0) [0|100] "C" Vector__XXX
 SG_ PICO_BMS_FB_temperature_battery_01_05_07  m66823: 31|16@0- (0.1,0) [0|100] "C" Vector__XXX
 SG_ PICO_BMS_FB_temperature_battery_01_05_08  m66824: 31|16@0- (0.1,0) [0|100] "C" Vector__XXX
 SG_ PICO_BMS_FB_temperature_battery_01_05_09  m66825: 31|16@0- (0.1,0) [0|100] "C" Vector__XXX
 SG_ PICO_BMS_FB_temperature_battery_01_05_10  m66826: 31|16@0- (0.1,0) [0|100] "C" Vector__XXX
 SG_ PICO_BMS_FB_temperature_battery_01_05_11  m66827: 31|16@0- (0.1,0) [0|100] "C" Vector__XXX
 SG_ PICO_BMS_FB_temperature_battery_01_05_12  m66828: 31|16@0- (0.1,0) [0|100] "C" Vector__XXX
 SG_ PICO_BMS_FB_temperature_battery_01_05_13  m66829: 31|16@0- (0.1,0) [0|100] "C" Vector__XXX
 SG_ PICO_BMS_FB_temperature_battery_01_05_14  m66830: 31|16@0- (0.1,0) [0|100] "C" Vector__XXX
 SG_ PICO_BMS_FB_temperature_battery_01_05_15  m66831: 31|16@0- (0.1,0) [0|100] "C" Vector__XXX
 SG_ PICO_BMS_FB_temperature_battery_01_06_00  m67072: 31|16@0- (0.1,0) [0|100] "C" Vector__XXX
 SG_ PICO_BMS_FB_temperature_battery_01_06_01  m67073: 31|16@0- (0.1,0) [0|100] "C" Vector__XXX
 SG_ PICO_BMS_FB_temperature_battery_01_06_02  m67074: 31|16@0- (0.1,0) [0|100] "C" Vector__XXX
 SG_ PICO_BMS_FB_temperature_battery_01_06_03  m67075: 31|16@0- (0.1,0) [0|100] "C" Vector__XXX
 SG_ PICO_BMS_FB_temperature_battery_01_06_04  m67076: 31|16@0- (0.1,0) [0|100] "C" Vector__XXX
 SG_ PICO_BMS_FB_temperature_battery_01_06_05  m67077: 31|16@0- (0.1,0) [0|100] "C" Vector__XXX
 SG_ PICO_BMS_FB_temperature_battery_01_06_06  m67078: 31|16@0- (0.1,0) [0|100] "C" Vector__XXX
 SG_ PICO_BMS_FB_temperature_battery_01_06_07  m67079: 31|16@0- (0.1,0) [0|100] "C" Vector__XXX
 SG_ PICO_BMS_FB_temperature_battery_01_06_08  m67080: 31|16@0- (0.1,0) [0|100] "C" Vector__XXX
 SG_ PICO_BMS_FB_temperature_battery_01_06_09  m67081: 31|16@0- (0.1,0) [0|100] "C" Vector__XXX
 SG_ PICO_BMS_FB_temperature_battery_01_06_10  m67082: 31|16@0- (0.1,0) [0|100] "C" Vector__XXX
 SG_ PICO_BMS_FB_temperature_battery_01_06_11  m67083: 31|16@0- (0.1,0) [0|100] "C" Vector__XXX
 SG_ PICO_BMS_FB_temperature_battery_01_06_12  m67084: 31|16@0- (0.1,0) [0|100] "C" Vector__XXX
 SG_ PICO_BMS_FB_temperature_battery_01_06_13  m67085: 31|16@0- (0.1,0) [0|100] "C" Vector__XXX
 SG_ PICO_BMS_FB_temperature_battery_01_06_14  m67086: 31|16@0- (0.1,0) [0|100] "C" Vector__XXX
 SG_ PICO_BMS_FB_temperature_battery_01_06_15  m67087: 31|16@0- (0.1,0) [0|100] "C" Vector__XXX
 SG_ PICO_BMS_FB_temperature_battery_01_07_00  m67328: 31|16@0- (0.1,0) [0|100] "C" Vector__XXX
 SG_ PICO_BMS_FB_temperature_battery_01_07_01  m67329: 31|16@0- (0.1,0) [0|100] "C" Vector__XXX
 SG_ PICO_BMS_FB_temperature_battery_01_07_02  m67330: 31|16@0- (0.1,0) [0|100] "C" Vector__XXX
 SG_ PICO_BMS_FB_temperature_battery_01_07_03  m67331: 31|16@0- (0.1,0) [0|100] "C" Vector__XXX
 SG_ PICO_BMS_FB_temperature_battery_01_07_04  m67332: 31|16@0- (0.1,0) [0|100] "C" Vector__XXX
 SG_ PICO_BMS_FB_temperature_battery_01_07_05  m67333: 31|16@0- (0.1,0) [0|100] "C" Vector__XXX
 SG_ PICO_BMS_FB_temperature_battery_01_07_06  m67334: 31|16@0- (0.1,0) [0|100] "C" Vector__XXX
 SG_ PICO_BMS_FB_temperature_battery_01_07_07  m67335: 31|16@0- (0.1,0) [0|100] "C" Vector__XXX
 SG_ PICO_BMS_FB_temperature_battery_01_07_08  m67336: 31|16@0- (0.1,0) [0|100] "C" Vector__XXX
 SG_ PICO_BMS_FB_temperature_battery_01_07_09  m67337: 31|16@0- (0.1,0) [0|100] "C" Vector__XXX
 SG_ PICO_BMS_FB_temperature_battery_01_07_10  m67338: 31|16@0- (0.1,0) [0|100] "C" Vector__XXX
 SG_ PICO_BMS_FB_temperature_battery_01_07_11  m67339: 31|16@0- (0.1,0) [0|100] "C" Vector__XXX
 SG_ PICO_BMS_FB_temperature_battery_01_07_12  m67340: 31|16@0- (0.1,0) [0|100] "C" Vector__XXX
 SG_ PICO_BMS_FB_temperature_battery_01_07_13  m67341: 31|16@0- (0.1,0) [0|100] "C" Vector__XXX
 SG_ PICO_BMS_FB_temperature_battery_01_07_14  m67342: 31|16@0- (0.1,0) [0|100] "C" Vector__XXX
 SG_ PICO_BMS_FB_temperature_battery_01_07_15  m67343: 31|16@0- (0.1,0) [0|100] "C" Vector__XXX
 SG_ PICO_BMS_FB_temperature_battery_01_08_00  m67584: 31|16@0- (0.1,0) [0|100] "C" Vector__XXX
 SG_ PICO_BMS_FB_temperature_battery_01_08_01  m67585: 31|16@0- (0.1,0) [0|100] "C" Vector__XXX
 SG_ PICO_BMS_FB_temperature_battery_01_08_02  m67586: 31|16@0- (0.1,0) [0|100] "C" Vector__XXX
 SG_ PICO_BMS_FB_temperature_battery_01_08_03  m67587: 31|16@0- (0.1,0) [0|100] "C" Vector__XXX
 SG_ PICO_BMS_FB_temperature_battery_01_08_04  m67588: 31|16@0- (0.1,0) [0|100] "C" Vector__XXX
 SG_ PICO_BMS_FB_temperature_battery_01_08_05  m67589: 31|16@0- (0.1,0) [0|100] "C" Vector__XXX
 SG_ PICO_BMS_FB_temperature_battery_01_08_06  m67590: 31|16@0- (0.1,0) [0|100] "C" Vector__XXX
 SG_ PICO_BMS_FB_temperature_battery_01_08_07  m67591: 31|16@0- (0.1,0) [0|100] "C" Vector__XXX
 SG_ PICO_BMS_FB_temperature_battery_01_08_08  m67592: 31|16@0- (0.1,0) [0|100] "C" Vector__XXX
 SG_ PICO_BMS_FB_temperature_battery_01_08_09  m67593: 31|16@0- (0.1,0) [0|100] "C" Vector__XXX
 SG_ PICO_BMS_FB_temperature_battery_01_08_10  m67594: 31|16@0- (0.1,0) [0|100] "C" Vector__XXX
 SG_ PICO_BMS_FB_temperature_battery_01_08_11  m67595: 31|16@0- (0.1,0) [0|100] "C" Vector__XXX
 SG_ PICO_BMS_FB_temperature_battery_01_08_12  m67596: 31|16@0- (0.1,0) [0|100] "C" Vector__XXX
 SG_ PICO_BMS_FB_temperature_battery_01_08_13  m67597: 31|16@0- (0.1,0) [0|100] "C" Vector__XXX
 SG_ PICO_BMS_FB_temperature_battery_01_08_14  m67598: 31|16@0- (0.1,0) [0|100] "C" Vector__XXX
 SG_ PICO_BMS_FB_temperature_battery_01_08_15  m67599: 31|16@0- (0.1,0) [0|100] "C" Vector__XXX
 SG_ PICO_BMS_FB_temperature_battery_01_09_00  m67840: 31|16@0- (0.1,0) [0|100] "C" Vector__XXX
 SG_ PICO_BMS_FB_temperature_battery_01_09_01  m67841: 31|16@0- (0.1,0) [0|100] "C" Vector__XXX
 SG_ PICO_BMS_FB_temperature_battery_01_09_02  m67842: 31|16@0- (0.1,0) [0|100] "C" Vector__XXX
 SG_ PICO_BMS_FB_temperature_battery_01_09_03  m67843: 31|16@0- (0.1,0) [0|100] "C" Vector__XXX
 SG_ PICO_BMS_FB_temperature_battery_01_09_04  m67844: 31|16@0- (0.1,0) [0|100] "C" Vector__XXX
 SG_ PICO_BMS_FB_temperature_battery_01_09_05  m67845: 31|16@0- (0.1,0) [0|100] "C" Vector__XXX
 SG_ PICO_BMS_FB_temperature_battery_01_09_06  m67846: 31|16@0- (0.1,0) [0|100] "C" Vector__XXX
 SG_ PICO_BMS_FB_temperature_battery_01_09_07  m67847: 31|16@0- (0.1,0) [0|100] "C" Vector__XXX
 SG_ PICO_BMS_FB_temperature_battery_01_09_08  m67848: 31|16@0- (0.1,0) [0|100] "C" Vector__XXX
 SG_ PICO_BMS_FB_temperature_battery_01_09_09  m67849: 31|16@0- (0.1,0) [0|100] "C" Vector__XXX
 SG_ PICO_BMS_FB_temperature_battery_01_09_10  m67850: 31|16@0- (0.1,0) [0|100] "C" Vector__XXX
 SG_ PICO_BMS_FB_temperature_battery_01_09_11  m67851: 31|16@0- (0.1,0) [0|100] "C" Vector__XXX
 SG_ PICO_BMS_FB_temperature_battery_01_09_12  m67852: 31|16@0- (0.1,0) [0|100] "C" Vector__XXX
 SG_ PICO_BMS_FB_temperature_battery_01_09_13  m67853: 31|16@0- (0.1,0) [0|100] "C" Vector__XXX
 SG_ PICO_BMS_FB_temperature_battery_01_09_14  m67854: 31|16@0- (0.1,0) [0|100] "C" Vector__XXX
 SG_ PICO_BMS_FB_temperature_battery_01_09_15  m67855: 31|16@0- (0.1,0) [0|100] "C" Vector__XXX
 SG_ PICO_BMS_FB_temperature_battery_01_10_00  m68096: 31|16@0- (0.1,0) [0|100] "C" Vector__XXX
 SG_ PICO_BMS_FB_temperature_battery_01_10_01  m68097: 31|16@0- (0.1,0) [0|100] "C" Vector__XXX
 SG_ PICO_BMS_FB_temperature_battery_01_10_02  m68098: 31|16@0- (0.1,0) [0|100] "C" Vector__XXX
 SG_ PICO_BMS_FB_temperature_battery_01_10_03  m68099: 31|16@0- (0.1,0) [0|100] "C" Vector__XXX
 SG_ PICO_BMS_FB_temperature_battery_01_10_04  m68100: 31|16@0- (0.1,0) [0|100] "C" Vector__XXX
 SG_ PICO_BMS_FB_temperature_battery_01_10_05  m68101: 31|16@0- (0.1,0) [0|100] "C" Vector__XXX
 SG_ PICO_BMS_FB_temperature_battery_01_10_06  m68102: 31|16@0- (0.1,0) [0|100] "C" Vector__XXX
 SG_ PICO_BMS_FB_temperature_battery_01_10_07  m68103: 31|16@0- (0.1,0) [0|100] "C" Vector__XXX
 SG_ PICO_BMS_FB_temperature_battery_01_10_08  m68104: 31|16@0- (0.1,0) [0|100] "C" Vector__XXX
 SG_ PICO_BMS_FB_temperature_battery_01_10_09  m68105: 31|16@0- (0.1,0) [0|100] "C" Vector__XXX
 SG_ PICO_BMS_FB_temperature_battery_01_10_10  m68106: 31|16@0- (0.1,0) [0|100] "C" Vector__XXX
 SG_ PICO_BMS_FB_temperature_battery_01_10_11  m68107: 31|16@0- (0.1,0) [0|100] "C" Vector__XXX
 SG_ PICO_BMS_FB_temperature_battery_01_10_12  m68108: 31|16@0- (0.1,0) [0|100] "C" Vector__XXX
 SG_ PICO_BMS_FB_temperature_battery_01_10_13  m68109: 31|16@0- (0.1,0) [0|100] "C" Vector__XXX
 SG_ PICO_BMS_FB_temperature_battery_01_10_14  m68110: 31|16@0- (0.1,0) [0|100] "C" Vector__XXX
 SG_ PICO_BMS_FB_temperature_battery_01_10_15  m68111: 31|16@0- (0.1,0) [0|100] "C" Vector__XXX
 SG_ PICO_BMS_FB_temperature_battery_01_11_00  m68352: 31|16@0- (0.1,0) [0|100] "C" Vector__XXX
 SG_ PICO_BMS_FB_temperature_battery_01_11_01  m68353: 31|16@0- (0.1,0) [0|100] "C" Vector__XXX
 SG_ PICO_BMS_FB_temperature_battery_01_11_02  m68354: 31|16@0- (0.1,0) [0|100] "C" Vector__XXX
 SG_ PICO_BMS_FB_temperature_battery_01_11_03  m68355: 31|16@0- (0.1,0) [0|100] "C" Vector__XXX
 SG_ PICO_BMS_FB_temperature_battery_01_11_04  m68356: 31|16@0- (0.1,0) [0|100] "C" Vector__XXX
 SG_ PICO_BMS_FB_temperature_battery_01_11_05  m68357: 31|16@0- (0.1,0) [0|100] "C" Vector__XXX
 SG_ PICO_BMS_FB_temperature_battery_01_11_06  m68358: 31|16@0- (0.1,0) [0|100] "C" Vector__XXX
 SG_ PICO_BMS_FB_temperature_battery_01_11_07  m68359: 31|16@0- (0.1,0) [0|100] "C" Vector__XXX
 SG_ PICO_BMS_FB_temperature_battery_01_11_08  m68360: 31|16@0- (0.1,0) [0|100] "C" Vector__XXX
 SG_ PICO_BMS_FB_temperature_battery_01_11_09  m68361: 31|16@0- (0.1,0) [0|100] "C" Vector__XXX
 SG_ PICO_BMS_FB_temperature_battery_01_11_10  m68362: 31|16@0- (0.1,0) [0|100] "C" Vector__XXX
 SG_ PICO_BMS_FB_temperature_battery_01_11_11  m68363: 31|16@0- (0.1,0) [0|100] "C" Vector__XXX
 SG_ PICO_BMS_FB_temperature_battery_01_11_12  m68364: 31|16@0- (0.1,0) [0|100] "C" Vector__XXX
 SG_ PICO_BMS_FB_temperature_battery_01_11_13  m68365: 31|16@0- (0.1,0) [0|100] "C" Vector__XXX
 SG_ PICO_BMS_FB_temperature_battery_01_11_14  m68366: 31|16@0- (0.1,0) [0|100] "C" Vector__XXX
 SG_ PICO_BMS_FB_temperature_battery_01_11_15  m68367: 31|16@0- (0.1,0) [0|100] "C" Vector__XXX
 SG_ PICO_BMS_FB_temperature_battery_01_12_00  m68608: 31|16@0- (0.1,0) [0|100] "C" Vector__XXX
 SG_ PICO_BMS_FB_temperature_battery_01_12_01  m68609: 31|16@0- (0.1,0) [0|100] "C" Vector__XXX
 SG_ PICO_BMS_FB_temperature_battery_01_12_02  m68610: 31|16@0- (0.1,0) [0|100] "C" Vector__XXX
 SG_ PICO_BMS_FB_temperature_battery_01_12_03  m68611: 31|16@0- (0.1,0) [0|100] "C" Vector__XXX
 SG_ PICO_BMS_FB_temperature_battery_01_12_04  m68612: 31|16@0- (0.1,0) [0|100] "C" Vector__XXX
 SG_ PICO_BMS_FB_temperature_battery_01_12_05  m68613: 31|16@0- (0.1,0) [0|100] "C" Vector__XXX
 SG_ PICO_BMS_FB_temperature_battery_01_12_06  m68614: 31|16@0- (0.1,0) [0|100] "C" Vector__XXX
 SG_ PICO_BMS_FB_temperature_battery_01_12_07  m68615: 31|16@0- (0.1,0) [0|100] "C" Vector__XXX
 SG_ PICO_BMS_FB_temperature_battery_01_12_08  m68616: 31|16@0- (0.1,0) [0|100] "C" Vector__XXX
 SG_ PICO_BMS_FB_temperature_battery_01_12_09  m68617: 31|16@0- (0.1,0) [0|100] "C" Vector__XXX
 SG_ PICO_BMS_FB_temperature_battery_01_12_10  m68618: 31|16@0- (0.1,0) [0|100] "C" Vector__XXX
 SG_ PICO_BMS_FB_temperature_battery_01_12_11  m68619: 31|16@0- (0.1,0) [0|100] "C" Vector__XXX
 SG_ PICO_BMS_FB_temperature_battery_01_12_12  m68620: 31|16@0- (0.1,0) [0|100] "C" Vector__XXX
 SG_ PICO_BMS_FB_temperature_battery_01_12_13  m68621: 31|16@0- (0.1,0) [0|100] "C" Vector__XXX
 SG_ PICO_BMS_FB_temperature_battery_01_12_14  m68622: 31|16@0- (0.1,0) [0|100] "C" Vector__XXX
 SG_ PICO_BMS_FB_temperature_battery_01_12_15  m68623: 31|16@0- (0.1,0) [0|100] "C" Vector__XXX
 SG_ PICO_BMS_FB_temperature_battery_01_13_00  m68864: 31|16@0- (0.1,0) [0|100] "C" Vector__XXX
 SG_ PICO_BMS_FB_temperature_battery_01_13_01  m68865: 31|16@0- (0.1,0) [0|100] "C" Vector__XXX
 SG_ PICO_BMS_FB_temperature_battery_01_13_02  m68866: 31|16@0- (0.1,0) [0|100] "C" Vector__XXX
 SG_ PICO_BMS_FB_temperature_battery_01_13_03  m68867: 31|16@0- (0.1,0) [0|100] "C" Vector__XXX
 SG_ PICO_BMS_FB_temperature_battery_01_13_04  m68868: 31|16@0- (0.1,0) [0|100] "C" Vector__XXX
 SG_ PICO_BMS_FB_temperature_battery_01_13_05  m68869: 31|16@0- (0.1,0) [0|100] "C" Vector__XXX
 SG_ PICO_BMS_FB_temperature_battery_01_13_06  m68870: 31|16@0- (0.1,0) [0|100] "C" Vector__XXX
 SG_ PICO_BMS_FB_temperature_battery_01_13_07  m68871: 31|16@0- (0.1,0) [0|100] "C" Vector__XXX
 SG_ PICO_BMS_FB_temperature_battery_01_13_08  m68872: 31|16@0- (0.1,0) [0|100] "C" Vector__XXX
 SG_ PICO_BMS_FB_temperature_battery_01_13_09  m68873: 31|16@0- (0.1,0) [0|100] "C" Vector__XXX
 SG_ PICO_BMS_FB_temperature_battery_01_13_10  m68874: 31|16@0- (0.1,0) [0|100] "C" Vector__XXX
 SG_ PICO_BMS_FB_temperature_battery_01_13_11  m68875: 31|16@0- (0.1,0) [0|100] "C" Vector__XXX
 SG_ PICO_BMS_FB_temperature_battery_01_13_12  m68876: 31|16@0- (0.1,0) [0|100] "C" Vector__XXX
 SG_ PICO_BMS_FB_temperature_battery_01_13_13  m68877: 31|16@0- (0.1,0) [0|100] "C" Vector__XXX
 SG_ PICO_BMS_FB_temperature_battery_01_13_14  m68878: 31|16@0- (0.1,0) [0|100] "C" Vector__XXX
 SG_ PICO_BMS_FB_temperature_battery_01_13_15  m68879: 31|16@0- (0.1,0) [0|100] "C" Vector__XXX
 SG_ PICO_BMS_FB_temperature_battery_01_14_00  m69120: 31|16@0- (0.1,0) [0|100] "C" Vector__XXX
 SG_ PICO_BMS_FB_temperature_battery_01_14_01  m69121: 31|16@0- (0.1,0) [0|100] "C" Vector__XXX
 SG_ PICO_BMS_FB_temperature_battery_01_14_02  m69122: 31|16@0- (0.1,0) [0|100] "C" Vector__XXX
 SG_ PICO_BMS_FB_temperature_battery_01_14_03  m69123: 31|16@0- (0.1,0) [0|100] "C" Vector__XXX
 SG_ PICO_BMS_FB_temperature_battery_01_14_04  m69124: 31|16@0- (0.1,0) [0|100] "C" Vector__XXX
 SG_ PICO_BMS_FB_temperature_battery_01_14_05  m69125: 31|16@0- (0.1,0) [0|100] "C" Vector__XXX
 SG_ PICO_BMS_FB_temperature_battery_01_14_06  m69126: 31|16@0- (0.1,0) [0|100] "C" Vector__XXX
 SG_ PICO_BMS_FB_temperature_battery_01_14_07  m69127: 31|16@0- (0.1,0) [0|100] "C" Vector__XXX
 SG_ PICO_BMS_FB_temperature_battery_01_14_08  m69128: 31|16@0- (0.1,0) [0|100] "C" Vector__XXX
 SG_ PICO_BMS_FB_temperature_battery_01_14_09  m69129: 31|16@0- (0.1,0) [0|100] "C" Vector__XXX
 SG_ PICO_BMS_FB_temperature_battery_01_14_10  m69130: 31|16@0- (0.1,0) [0|100] "C" Vector__XXX
 SG_ PICO_BMS_FB_temperature_battery_01_14_11  m69131: 31|16@0- (0.1,0) [0|100] "C" Vector__XXX
 SG_ PICO_BMS_FB_temperature_battery_01_14_12  m69132: 31|16@0- (0.1,0) [0|100] "C" Vector__XXX
 SG_ PICO_BMS_FB_temperature_battery_01_14_13  m69133: 31|16@0- (0.1,0) [0|100] "C" Vector__XXX
 SG_ PICO_BMS_FB_temperature_battery_01_14_14  m69134: 31|16@0- (0.1,0) [0|100] "C" Vector__XXX
 SG_ PICO_BMS_FB_temperature_battery_01_14_15  m69135: 31|16@0- (0.1,0) [0|100] "C" Vector__XXX
 SG_ PICO_BMS_FB_temperature_battery_01_15_00  m69376: 31|16@0- (0.1,0) [0|100] "C" Vector__XXX
 SG_ PICO_BMS_FB_temperature_battery_01_15_01  m69377: 31|16@0- (0.1,0) [0|100] "C" Vector__XXX
 SG_ PICO_BMS_FB_temperature_battery_01_15_02  m69378: 31|16@0- (0.1,0) [0|100] "C" Vector__XXX
 SG_ PICO_BMS_FB_temperature_battery_01_15_03  m69379: 31|16@0- (0.1,0) [0|100] "C" Vector__XXX
 SG_ PICO_BMS_FB_temperature_battery_01_15_04  m69380: 31|16@0- (0.1,0) [0|100] "C" Vector__XXX
 SG_ PICO_BMS_FB_temperature_battery_01_15_05  m69381: 31|16@0- (0.1,0) [0|100] "C" Vector__XXX
 SG_ PICO_BMS_FB_temperature_battery_01_15_06  m69382: 31|16@0- (0.1,0) [0|100] "C" Vector__XXX
 SG_ PICO_BMS_FB_temperature_battery_01_15_07  m69383: 31|16@0- (0.1,0) [0|100] "C" Vector__XXX
 SG_ PICO_BMS_FB_temperature_battery_01_15_08  m69384: 31|16@0- (0.1,0) [0|100] "C" Vector__XXX
 SG_ PICO_BMS_FB_temperature_battery_01_15_09  m69385: 31|16@0- (0.1,0) [0|100] "C" Vector__XXX
 SG_ PICO_BMS_FB_temperature_battery_01_15_10  m69386: 31|16@0- (0.1,0) [0|100] "C" Vector__XXX
 SG_ PICO_BMS_FB_temperature_battery_01_15_11  m69387: 31|16@0- (0.1,0) [0|100] "C" Vector__XXX
 SG_ PICO_BMS_FB_temperature_battery_01_15_12  m69388: 31|16@0- (0.1,0) [0|100] "C" Vector__XXX
 SG_ PICO_BMS_FB_temperature_battery_01_15_13  m69389: 31|16@0- (0.1,0) [0|100] "C" Vector__XXX
 SG_ PICO_BMS_FB_temperature_battery_01_15_14  m69390: 31|16@0- (0.1,0) [0|100] "C" Vector__XXX
 SG_ PICO_BMS_FB_temperature_battery_01_15_15  m69391: 31|16@0- (0.1,0) [0|100] "C" Vector__XXX
 SG_ PICO_BMS_FB_temperature_battery_02_00_00  m131072: 31|16@0- (0.1,0) [0|100] "C" Vector__XXX
 SG_ PICO_BMS_FB_temperature_battery_02_00_01  m131073: 31|16@0- (0.1,0) [0|100] "C" Vector__XXX
 SG_ PICO_BMS_FB_temperature_battery_02_00_02  m131074: 31|16@0- (0.1,0) [0|100] "C" Vector__XXX
 SG_ PICO_BMS_FB_temperature_battery_02_00_03  m131075: 31|16@0- (0.1,0) [0|100] "C" Vector__XXX
 SG_ PICO_BMS_FB_temperature_battery_02_00_04  m131076: 31|16@0- (0.1,0) [0|100] "C" Vector__XXX
 SG_ PICO_BMS_FB_temperature_battery_02_00_05  m131077: 31|16@0- (0.1,0) [0|100] "C" Vector__XXX
 SG_ PICO_BMS_FB_temperature_battery_02_00_06  m131078: 31|16@0- (0.1,0) [0|100] "C" Vector__XXX
 SG_ PICO_BMS_FB_temperature_battery_02_00_07  m131079: 31|16@0- (0.1,0) [0|100] "C" Vector__XXX
 SG_ PICO_BMS_FB_temperature_battery_02_00_08  m131080: 31|16@0- (0.1,0) [0|100] "C" Vector__XXX
 SG_ PICO_BMS_FB_temperature_battery_02_00_09  m131081: 31|16@0- (0.1,0) [0|100] "C" Vector__XXX
 SG_ PICO_BMS_FB_temperature_battery_02_00_10  m131082: 31|16@0- (0.1,0) [0|100] "C" Vector__XXX
 SG_ PICO_BMS_FB_temperature_battery_02_00_11  m131083: 31|16@0- (0.1,0) [0|100] "C" Vector__XXX
 SG_ PICO_BMS_FB_temperature_battery_02_00_12  m131084: 31|16@0- (0.1,0) [0|100] "C" Vector__XXX
 SG_ PICO_BMS_FB_temperature_battery_02_00_13  m131085: 31|16@0- (0.1,0) [0|100] "C" Vector__XXX
 SG_ PICO_BMS_FB_temperature_battery_02_00_14  m131086: 31|16@0- (0.1,0) [0|100] "C" Vector__XXX
 SG_ PICO_BMS_FB_temperature_battery_02_00_15  m131087: 31|16@0- (0.1,0) [0|100] "C" Vector__XXX
 SG_ PICO_BMS_FB_temperature_battery_02_01_00  m131328: 31|16@0- (0.1,0) [0|100] "C" Vector__XXX
 SG_ PICO_BMS_FB_temperature_battery_02_01_01  m131329: 31|16@0- (0.1,0) [0|100] "C" Vector__XXX
 SG_ PICO_BMS_FB_temperature_battery_02_01_02  m131330: 31|16@0- (0.1,0) [0|100] "C" Vector__XXX
 SG_ PICO_BMS_FB_temperature_battery_02_01_03  m131331: 31|16@0- (0.1,0) [0|100] "C" Vector__XXX
 SG_ PICO_BMS_FB_temperature_battery_02_01_04  m131332: 31|16@0- (0.1,0) [0|100] "C" Vector__XXX
 SG_ PICO_BMS_FB_temperature_battery_02_01_05  m131333: 31|16@0- (0.1,0) [0|100] "C" Vector__XXX
 SG_ PICO_BMS_FB_temperature_battery_02_01_06  m131334: 31|16@0- (0.1,0) [0|100] "C" Vector__XXX
 SG_ PICO_BMS_FB_temperature_battery_02_01_07  m131335: 31|16@0- (0.1,0) [0|100] "C" Vector__XXX
 SG_ PICO_BMS_FB_temperature_battery_02_01_08  m131336: 31|16@0- (0.1,0) [0|100] "C" Vector__XXX
 SG_ PICO_BMS_FB_temperature_battery_02_01_09  m131337: 31|16@0- (0.1,0) [0|100] "C" Vector__XXX
 SG_ PICO_BMS_FB_temperature_battery_02_01_10  m131338: 31|16@0- (0.1,0) [0|100] "C" Vector__XXX
 SG_ PICO_BMS_FB_temperature_battery_02_01_11  m131339: 31|16@0- (0.1,0) [0|100] "C" Vector__XXX
 SG_ PICO_BMS_FB_temperature_battery_02_01_12  m131340: 31|16@0- (0.1,0) [0|100] "C" Vector__XXX
 SG_ PICO_BMS_FB_temperature_battery_02_01_13  m131341: 31|16@0- (0.1,0) [0|100] "C" Vector__XXX
 SG_ PICO_BMS_FB_temperature_battery_02_01_14  m131342: 31|16@0- (0.1,0) [0|100] "C" Vector__XXX
 SG_ PICO_BMS_FB_temperature_battery_02_01_15  m131343: 31|16@0- (0.1,0) [0|100] "C" Vector__XXX
 SG_ PICO_BMS_FB_temperature_battery_02_02_00  m131584: 31|16@0- (0.1,0) [0|100] "C" Vector__XXX
 SG_ PICO_BMS_FB_temperature_battery_02_02_01  m131585: 31|16@0- (0.1,0) [0|100] "C" Vector__XXX
 SG_ PICO_BMS_FB_temperature_battery_02_02_02  m131586: 31|16@0- (0.1,0) [0|100] "C" Vector__XXX
 SG_ PICO_BMS_FB_temperature_battery_02_02_03  m131587: 31|16@0- (0.1,0) [0|100] "C" Vector__XXX
 SG_ PICO_BMS_FB_temperature_battery_02_02_04  m131588: 31|16@0- (0.1,0) [0|100] "C" Vector__XXX
 SG_ PICO_BMS_FB_temperature_battery_02_02_05  m131589: 31|16@0- (0.1,0) [0|100] "C" Vector__XXX
 SG_ PICO_BMS_FB_temperature_battery_02_02_06  m131590: 31|16@0- (0.1,0) [0|100] "C" Vector__XXX
 SG_ PICO_BMS_FB_temperature_battery_02_02_07  m131591: 31|16@0- (0.1,0) [0|100] "C" Vector__XXX
 SG_ PICO_BMS_FB_temperature_battery_02_02_08  m131592: 31|16@0- (0.1,0) [0|100] "C" Vector__XXX
 SG_ PICO_BMS_FB_temperature_battery_02_02_09  m131593: 31|16@0- (0.1,0) [0|100] "C" Vector__XXX
 SG_ PICO_BMS_FB_temperature_battery_02_02_10  m131594: 31|16@0- (0.1,0) [0|100] "C" Vector__XXX
 SG_ PICO_BMS_FB_temperature_battery_02_02_11  m131595: 31|16@0- (0.1,0) [0|100] "C" Vector__XXX
 SG_ PICO_BMS_FB_temperature_battery_02_02_12  m131596: 31|16@0- (0.1,0) [0|100] "C" Vector__XXX
 SG_ PICO_BMS_FB_temperature_battery_02_02_13  m131597: 31|16@0- (0.1,0) [0|100] "C" Vector__XXX
 SG_ PICO_BMS_FB_temperature_battery_02_02_14  m131598: 31|16@0- (0.1,0) [0|100] "C" Vector__XXX
 SG_ PICO_BMS_FB_temperature_battery_02_02_15  m131599: 31|16@0- (0.1,0) [0|100] "C" Vector__XXX
 SG_ PICO_BMS_FB_temperature_battery_02_03_00  m131840: 31|16@0- (0.1,0) [0|100] "C" Vector__XXX
 SG_ PICO_BMS_FB_temperature_battery_02_03_01  m131841: 31|16@0- (0.1,0) [0|100] "C" Vector__XXX
 SG_ PICO_BMS_FB_temperature_battery_02_03_02  m131842: 31|16@0- (0.1,0) [0|100] "C" Vector__XXX
 SG_ PICO_BMS_FB_temperature_battery_02_03_03  m131843: 31|16@0- (0.1,0) [0|100] "C" Vector__XXX
 SG_ PICO_BMS_FB_temperature_battery_02_03_04  m131844: 31|16@0- (0.1,0) [0|100] "C" Vector__XXX
 SG_ PICO_BMS_FB_temperature_battery_02_03_05  m131845: 31|16@0- (0.1,0) [0|100] "C" Vector__XXX
 SG_ PICO_BMS_FB_temperature_battery_02_03_06  m131846: 31|16@0- (0.1,0) [0|100] "C" Vector__XXX
 SG_ PICO_BMS_FB_temperature_battery_02_03_07  m131847: 31|16@0- (0.1,0) [0|100] "C" Vector__XXX
 SG_ PICO_BMS_FB_temperature_battery_02_03_08  m131848: 31|16@0- (0.1,0) [0|100] "C" Vector__XXX
 SG_ PICO_BMS_FB_temperature_battery_02_03_09  m131849: 31|16@0- (0.1,0) [0|100] "C" Vector__XXX
 SG_ PICO_BMS_FB_temperature_battery_02_03_10  m131850: 31|16@0- (0.1,0) [0|100] "C" Vector__XXX
 SG_ PICO_BMS_FB_temperature_battery_02_03_11  m131851: 31|16@0- (0.1,0) [0|100] "C" Vector__XXX
 SG_ PICO_BMS_FB_temperature_battery_02_03_12  m131852: 31|16@0- (0.1,0) [0|100] "C" Vector__XXX
 SG_ PICO_BMS_FB_temperature_battery_02_03_13  m131853: 31|16@0- (0.1,0) [0|100] "C" Vector__XXX
 SG_ PICO_BMS_FB_temperature_battery_02_03_14  m131854: 31|16@0- (0.1,0) [0|100] "C" Vector__XXX
 SG_ PICO_BMS_FB_temperature_battery_02_03_15  m131855: 31|16@0- (0.1,0) [0|100] "C" Vector__XXX
 SG_ PICO_BMS_FB_temperature_battery_02_04_00  m132096: 31|16@0- (0.1,0) [0|100] "C" Vector__XXX
 SG_ PICO_BMS_FB_temperature_battery_02_04_01  m132097: 31|16@0- (0.1,0) [0|100] "C" Vector__XXX
 SG_ PICO_BMS_FB_temperature_battery_02_04_02  m132098: 31|16@0- (0.1,0) [0|100] "C" Vector__XXX
 SG_ PICO_BMS_FB_temperature_battery_02_04_03  m132099: 31|16@0- (0.1,0) [0|100] "C" Vector__XXX
 SG_ PICO_BMS_FB_temperature_battery_02_04_04  m132100: 31|16@0- (0.1,0) [0|100] "C" Vector__XXX
 SG_ PICO_BMS_FB_temperature_battery_02_04_05  m132101: 31|16@0- (0.1,0) [0|100] "C" Vector__XXX
 SG_ PICO_BMS_FB_temperature_battery_02_04_06  m132102: 31|16@0- (0.1,0) [0|100] "C" Vector__XXX
 SG_ PICO_BMS_FB_temperature_battery_02_04_07  m132103: 31|16@0- (0.1,0) [0|100] "C" Vector__XXX
 SG_ PICO_BMS_FB_temperature_battery_02_04_08  m132104: 31|16@0- (0.1,0) [0|100] "C" Vector__XXX
 SG_ PICO_BMS_FB_temperature_battery_02_04_09  m132105: 31|16@0- (0.1,0) [0|100] "C" Vector__XXX
 SG_ PICO_BMS_FB_temperature_battery_02_04_10  m132106: 31|16@0- (0.1,0) [0|100] "C" Vector__XXX
 SG_ PICO_BMS_FB_temperature_battery_02_04_11  m132107: 31|16@0- (0.1,0) [0|100] "C" Vector__XXX
 SG_ PICO_BMS_FB_temperature_battery_02_04_12  m132108: 31|16@0- (0.1,0) [0|100] "C" Vector__XXX
 SG_ PICO_BMS_FB_temperature_battery_02_04_13  m132109: 31|16@0- (0.1,0) [0|100] "C" Vector__XXX
 SG_ PICO_BMS_FB_temperature_battery_02_04_14  m132110: 31|16@0- (0.1,0) [0|100] "C" Vector__XXX
 SG_ PICO_BMS_FB_temperature_battery_02_04_15  m132111: 31|16@0- (0.1,0) [0|100] "C" Vector__XXX
 SG_ PICO_BMS_FB_temperature_battery_02_05_00  m132352: 31|16@0- (0.1,0) [0|100] "C" Vector__XXX
 SG_ PICO_BMS_FB_temperature_battery_02_05_01  m132353: 31|16@0- (0.1,0) [0|100] "C" Vector__XXX
 SG_ PICO_BMS_FB_temperature_battery_02_05_02  m132354: 31|16@0- (0.1,0) [0|100] "C" Vector__XXX
 SG_ PICO_BMS_FB_temperature_battery_02_05_03  m132355: 31|16@0- (0.1,0) [0|100] "C" Vector__XXX
 SG_ PICO_BMS_FB_temperature_battery_02_05_04  m132356: 31|16@0- (0.1,0) [0|100] "C" Vector__XXX
 SG_ PICO_BMS_FB_temperature_battery_02_05_05  m132357: 31|16@0- (0.1,0) [0|100] "C" Vector__XXX
 SG_ PICO_BMS_FB_temperature_battery_02_05_06  m132358: 31|16@0- (0.1,0) [0|100] "C" Vector__XXX
 SG_ PICO_BMS_FB_temperature_battery_02_05_07  m132359: 31|16@0- (0.1,0) [0|100] "C" Vector__XXX
 SG_ PICO_BMS_FB_temperature_battery_02_05_08  m132360: 31|16@0- (0.1,0) [0|100] "C" Vector__XXX
 SG_ PICO_BMS_FB_temperature_battery_02_05_09  m132361: 31|16@0- (0.1,0) [0|100] "C" Vector__XXX
 SG_ PICO_BMS_FB_temperature_battery_02_05_10  m132362: 31|16@0- (0.1,0) [0|100] "C" Vector__XXX
 SG_ PICO_BMS_FB_temperature_battery_02_05_11  m132363: 31|16@0- (0.1,0) [0|100] "C" Vector__XXX
 SG_ PICO_BMS_FB_temperature_battery_02_05_12  m132364: 31|16@0- (0.1,0) [0|100] "C" Vector__XXX
 SG_ PICO_BMS_FB_temperature_battery_02_05_13  m132365: 31|16@0- (0.1,0) [0|100] "C" Vector__XXX
 SG_ PICO_BMS_FB_temperature_battery_02_05_14  m132366: 31|16@0- (0.1,0) [0|100] "C" Vector__XXX
 SG_ PICO_BMS_FB_temperature_battery_02_05_15  m132367: 31|16@0- (0.1,0) [0|100] "C" Vector__XXX
 SG_ PICO_BMS_FB_temperature_battery_02_06_00  m132608: 31|16@0- (0.1,0) [0|100] "C" Vector__XXX
 SG_ PICO_BMS_FB_temperature_battery_02_06_01  m132609: 31|16@0- (0.1,0) [0|100] "C" Vector__XXX
 SG_ PICO_BMS_FB_temperature_battery_02_06_02  m132610: 31|16@0- (0.1,0) [0|100] "C" Vector__XXX
 SG_ PICO_BMS_FB_temperature_battery_02_06_03  m132611: 31|16@0- (0.1,0) [0|100] "C" Vector__XXX
 SG_ PICO_BMS_FB_temperature_battery_02_06_04  m132612: 31|16@0- (0.1,0) [0|100] "C" Vector__XXX
 SG_ PICO_BMS_FB_temperature_battery_02_06_05  m132613: 31|16@0- (0.1,0) [0|100] "C" Vector__XXX
 SG_ PICO_BMS_FB_temperature_battery_02_06_06  m132614: 31|16@0- (0.1,0) [0|100] "C" Vector__XXX
 SG_ PICO_BMS_FB_temperature_battery_02_06_07  m132615: 31|16@0- (0.1,0) [0|100] "C" Vector__XXX
 SG_ PICO_BMS_FB_temperature_battery_02_06_08  m132616: 31|16@0- (0.1,0) [0|100] "C" Vector__XXX
 SG_ PICO_BMS_FB_temperature_battery_02_06_09  m132617: 31|16@0- (0.1,0) [0|100] "C" Vector__XXX
 SG_ PICO_BMS_FB_temperature_battery_02_06_10  m132618: 31|16@0- (0.1,0) [0|100] "C" Vector__XXX
 SG_ PICO_BMS_FB_temperature_battery_02_06_11  m132619: 31|16@0- (0.1,0) [0|100] "C" Vector__XXX
 SG_ PICO_BMS_FB_temperature_battery_02_06_12  m132620: 31|16@0- (0.1,0) [0|100] "C" Vector__XXX
 SG_ PICO_BMS_FB_temperature_battery_02_06_13  m132621: 31|16@0- (0.1,0) [0|100] "C" Vector__XXX
 SG_ PICO_BMS_FB_temperature_battery_02_06_14  m132622: 31|16@0- (0.1,0) [0|100] "C" Vector__XXX
 SG_ PICO_BMS_FB_temperature_battery_02_06_15  m132623: 31|16@0- (0.1,0) [0|100] "C" Vector__XXX
 SG_ PICO_BMS_FB_temperature_battery_02_07_00  m132864: 31|16@0- (0.1,0) [0|100] "C" Vector__XXX
 SG_ PICO_BMS_FB_temperature_battery_02_07_01  m132865: 31|16@0- (0.1,0) [0|100] "C" Vector__XXX
 SG_ PICO_BMS_FB_temperature_battery_02_07_02  m132866: 31|16@0- (0.1,0) [0|100] "C" Vector__XXX
 SG_ PICO_BMS_FB_temperature_battery_02_07_03  m132867: 31|16@0- (0.1,0) [0|100] "C" Vector__XXX
 SG_ PICO_BMS_FB_temperature_battery_02_07_04  m132868: 31|16@0- (0.1,0) [0|100] "C" Vector__XXX
 SG_ PICO_BMS_FB_temperature_battery_02_07_05  m132869: 31|16@0- (0.1,0) [0|100] "C" Vector__XXX
 SG_ PICO_BMS_FB_temperature_battery_02_07_06  m132870: 31|16@0- (0.1,0) [0|100] "C" Vector__XXX
 SG_ PICO_BMS_FB_temperature_battery_02_07_07  m132871: 31|16@0- (0.1,0) [0|100] "C" Vector__XXX
 SG_ PICO_BMS_FB_temperature_battery_02_07_08  m132872: 31|16@0- (0.1,0) [0|100] "C" Vector__XXX
 SG_ PICO_BMS_FB_temperature_battery_02_07_09  m132873: 31|16@0- (0.1,0) [0|100] "C" Vector__XXX
 SG_ PICO_BMS_FB_temperature_battery_02_07_10  m132874: 31|16@0- (0.1,0) [0|100] "C" Vector__XXX
 SG_ PICO_BMS_FB_temperature_battery_02_07_11  m132875: 31|16@0- (0.1,0) [0|100] "C" Vector__XXX
 SG_ PICO_BMS_FB_temperature_battery_02_07_12  m132876: 31|16@0- (0.1,0) [0|100] "C" Vector__XXX
 SG_ PICO_BMS_FB_temperature_battery_02_07_13  m132877: 31|16@0- (0.1,0) [0|100] "C" Vector__XXX
 SG_ PICO_BMS_FB_temperature_battery_02_07_14  m132878: 31|16@0- (0.1,0) [0|100] "C" Vector__XXX
 SG_ PICO_BMS_FB_temperature_battery_02_07_15  m132879: 31|16@0- (0.1,0) [0|100] "C" Vector__XXX
 SG_ PICO_BMS_FB_temperature_battery_02_08_00  m133120: 31|16@0- (0.1,0) [0|100] "C" Vector__XXX
 SG_ PICO_BMS_FB_temperature_battery_02_08_01  m133121: 31|16@0- (0.1,0) [0|100] "C" Vector__XXX
 SG_ PICO_BMS_FB_temperature_battery_02_08_02  m133122: 31|16@0- (0.1,0) [0|100] "C" Vector__XXX
 SG_ PICO_BMS_FB_temperature_battery_02_08_03  m133123: 31|16@0- (0.1,0) [0|100] "C" Vector__XXX
 SG_ PICO_BMS_FB_temperature_battery_02_08_04  m133124: 31|16@0- (0.1,0) [0|100] "C" Vector__XXX
 SG_ PICO_BMS_FB_temperature_battery_02_08_05  m133125: 31|16@0- (0.1,0) [0|100] "C" Vector__XXX
 SG_ PICO_BMS_FB_temperature_battery_02_08_06  m133126: 31|16@0- (0.1,0) [0|100] "C" Vector__XXX
 SG_ PICO_BMS_FB_temperature_battery_02_08_07  m133127: 31|16@0- (0.1,0) [0|100] "C" Vector__XXX
 SG_ PICO_BMS_FB_temperature_battery_02_08_08  m133128: 31|16@0- (0.1,0) [0|100] "C" Vector__XXX
 SG_ PICO_BMS_FB_temperature_battery_02_08_09  m133129: 31|16@0- (0.1,0) [0|100] "C" Vector__XXX
 SG_ PICO_BMS_FB_temperature_battery_02_08_10  m133130: 31|16@0- (0.1,0) [0|100] "C" Vector__XXX
 SG_ PICO_BMS_FB_temperature_battery_02_08_11  m133131: 31|16@0- (0.1,0) [0|100] "C" Vector__XXX
 SG_ PICO_BMS_FB_temperature_battery_02_08_12  m133132: 31|16@0- (0.1,0) [0|100] "C" Vector__XXX
 SG_ PICO_BMS_FB_temperature_battery_02_08_13  m133133: 31|16@0- (0.1,0) [0|100] "C" Vector__XXX
 SG_ PICO_BMS_FB_temperature_battery_02_08_14  m133134: 31|16@0- (0.1,0) [0|100] "C" Vector__XXX
 SG_ PICO_BMS_FB_temperature_battery_02_08_15  m133135: 31|16@0- (0.1,0) [0|100] "C" Vector__XXX
 SG_ PICO_BMS_FB_temperature_battery_02_09_00  m133376: 31|16@0- (0.1,0) [0|100] "C" Vector__XXX
 SG_ PICO_BMS_FB_temperature_battery_02_09_01  m133377: 31|16@0- (0.1,0) [0|100] "C" Vector__XXX
 SG_ PICO_BMS_FB_temperature_battery_02_09_02  m133378: 31|16@0- (0.1,0) [0|100] "C" Vector__XXX
 SG_ PICO_BMS_FB_temperature_battery_02_09_03  m133379: 31|16@0- (0.1,0) [0|100] "C" Vector__XXX
 SG_ PICO_BMS_FB_temperature_battery_02_09_04  m133380: 31|16@0- (0.1,0) [0|100] "C" Vector__XXX
 SG_ PICO_BMS_FB_temperature_battery_02_09_05  m133381: 31|16@0- (0.1,0) [0|100] "C" Vector__XXX
 SG_ PICO_BMS_FB_temperature_battery_02_09_06  m133382: 31|16@0- (0.1,0) [0|100] "C" Vector__XXX
 SG_ PICO_BMS_FB_temperature_battery_02_09_07  m133383: 31|16@0- (0.1,0) [0|100] "C" Vector__XXX
 SG_ PICO_BMS_FB_temperature_battery_02_09_08  m133384: 31|16@0- (0.1,0) [0|100] "C" Vector__XXX
 SG_ PICO_BMS_FB_temperature_battery_02_09_09  m133385: 31|16@0- (0.1,0) [0|100] "C" Vector__XXX
 SG_ PICO_BMS_FB_temperature_battery_02_09_10  m133386: 31|16@0- (0.1,0) [0|100] "C" Vector__XXX
 SG_ PICO_BMS_FB_temperature_battery_02_09_11  m133387: 31|16@0- (0.1,0) [0|100] "C" Vector__XXX
 SG_ PICO_BMS_FB_temperature_battery_02_09_12  m133388: 31|16@0- (0.1,0) [0|100] "C" Vector__XXX
 SG_ PICO_BMS_FB_temperature_battery_02_09_13  m133389: 31|16@0- (0.1,0) [0|100] "C" Vector__XXX
 SG_ PICO_BMS_FB_temperature_battery_02_09_14  m133390: 31|16@0- (0.1,0) [0|100] "C" Vector__XXX
 SG_ PICO_BMS_FB_temperature_battery_02_09_15  m133391: 31|16@0- (0.1,0) [0|100] "C" Vector__XXX
 SG_ PICO_BMS_FB_temperature_battery_02_10_00  m133632: 31|16@0- (0.1,0) [0|100] "C" Vector__XXX
 SG_ PICO_BMS_FB_temperature_battery_02_10_01  m133633: 31|16@0- (0.1,0) [0|100] "C" Vector__XXX
 SG_ PICO_BMS_FB_temperature_battery_02_10_02  m133634: 31|16@0- (0.1,0) [0|100] "C" Vector__XXX
 SG_ PICO_BMS_FB_temperature_battery_02_10_03  m133635: 31|16@0- (0.1,0) [0|100] "C" Vector__XXX
 SG_ PICO_BMS_FB_temperature_battery_02_10_04  m133636: 31|16@0- (0.1,0) [0|100] "C" Vector__XXX
 SG_ PICO_BMS_FB_temperature_battery_02_10_05  m133637: 31|16@0- (0.1,0) [0|100] "C" Vector__XXX
 SG_ PICO_BMS_FB_temperature_battery_02_10_06  m133638: 31|16@0- (0.1,0) [0|100] "C" Vector__XXX
 SG_ PICO_BMS_FB_temperature_battery_02_10_07  m133639: 31|16@0- (0.1,0) [0|100] "C" Vector__XXX
 SG_ PICO_BMS_FB_temperature_battery_02_10_08  m133640: 31|16@0- (0.1,0) [0|100] "C" Vector__XXX
 SG_ PICO_BMS_FB_temperature_battery_02_10_09  m133641: 31|16@0- (0.1,0) [0|100] "C" Vector__XXX
 SG_ PICO_BMS_FB_temperature_battery_02_10_10  m133642: 31|16@0- (0.1,0) [0|100] "C" Vector__XXX
 SG_ PICO_BMS_FB_temperature_battery_02_10_11  m133643: 31|16@0- (0.1,0) [0|100] "C" Vector__XXX
 SG_ PICO_BMS_FB_temperature_battery_02_10_12  m133644: 31|16@0- (0.1,0) [0|100] "C" Vector__XXX
 SG_ PICO_BMS_FB_temperature_battery_02_10_13  m133645: 31|16@0- (0.1,0) [0|100] "C" Vector__XXX
 SG_ PICO_BMS_FB_temperature_battery_02_10_14  m133646: 31|16@0- (0.1,0) [0|100] "C" Vector__XXX
 SG_ PICO_BMS_FB_temperature_battery_02_10_15  m133647: 31|16@0- (0.1,0) [0|100] "C" Vector__XXX
 SG_ PICO_BMS_FB_temperature_battery_02_11_00  m133888: 31|16@0- (0.1,0) [0|100] "C" Vector__XXX
 SG_ PICO_BMS_FB_temperature_battery_02_11_01  m133889: 31|16@0- (0.1,0) [0|100] "C" Vector__XXX
 SG_ PICO_BMS_FB_temperature_battery_02_11_02  m133890: 31|16@0- (0.1,0) [0|100] "C" Vector__XXX
 SG_ PICO_BMS_FB_temperature_battery_02_11_03  m133891: 31|16@0- (0.1,0) [0|100] "C" Vector__XXX
 SG_ PICO_BMS_FB_temperature_battery_02_11_04  m133892: 31|16@0- (0.1,0) [0|100] "C" Vector__XXX
 SG_ PICO_BMS_FB_temperature_battery_02_11_05  m133893: 31|16@0- (0.1,0) [0|100] "C" Vector__XXX
 SG_ PICO_BMS_FB_temperature_battery_02_11_06  m133894: 31|16@0- (0.1,0) [0|100] "C" Vector__XXX
 SG_ PICO_BMS_FB_temperature_battery_02_11_07  m133895: 31|16@0- (0.1,0) [0|100] "C" Vector__XXX
 SG_ PICO_BMS_FB_temperature_battery_02_11_08  m133896: 31|16@0- (0.1,0) [0|100] "C" Vector__XXX
 SG_ PICO_BMS_FB_temperature_battery_02_11_09  m133897: 31|16@0- (0.1,0) [0|100] "C" Vector__XXX
 SG_ PICO_BMS_FB_temperature_battery_02_11_10  m133898: 31|16@0- (0.1,0) [0|100] "C" Vector__XXX
 SG_ PICO_BMS_FB_temperature_battery_02_11_11  m133899: 31|16@0- (0.1,0) [0|100] "C" Vector__XXX
 SG_ PICO_BMS_FB_temperature_battery_02_11_12  m133900: 31|16@0- (0.1,0) [0|100] "C" Vector__XXX
 SG_ PICO_BMS_FB_temperature_battery_02_11_13  m133901: 31|16@0- (0.1,0) [0|100] "C" Vector__XXX
 SG_ PICO_BMS_FB_temperature_battery_02_11_14  m133902: 31|16@0- (0.1,0) [0|100] "C" Vector__XXX
 SG_ PICO_BMS_FB_temperature_battery_02_11_15  m133903: 31|16@0- (0.1,0) [0|100] "C" Vector__XXX
 SG_ PICO_BMS_FB_temperature_battery_02_12_00  m134144: 31|16@0- (0.1,0) [0|100] "C" Vector__XXX
 SG_ PICO_BMS_FB_temperature_battery_02_12_01  m134145: 31|16@0- (0.1,0) [0|100] "C" Vector__XXX
 SG_ PICO_BMS_FB_temperature_battery_02_12_02  m134146: 31|16@0- (0.1,0) [0|100] "C" Vector__XXX
 SG_ PICO_BMS_FB_temperature_battery_02_12_03  m134147: 31|16@0- (0.1,0) [0|100] "C" Vector__XXX
 SG_ PICO_BMS_FB_temperature_battery_02_12_04  m134148: 31|16@0- (0.1,0) [0|100] "C" Vector__XXX
 SG_ PICO_BMS_FB_temperature_battery_02_12_05  m134149: 31|16@0- (0.1,0) [0|100] "C" Vector__XXX
 SG_ PICO_BMS_FB_temperature_battery_02_12_06  m134150: 31|16@0- (0.1,0) [0|100] "C" Vector__XXX
 SG_ PICO_BMS_FB_temperature_battery_02_12_07  m134151: 31|16@0- (0.1,0) [0|100] "C" Vector__XXX
 SG_ PICO_BMS_FB_temperature_battery_02_12_08  m134152: 31|16@0- (0.1,0) [0|100] "C" Vector__XXX
 SG_ PICO_BMS_FB_temperature_battery_02_12_09  m134153: 31|16@0- (0.1,0) [0|100] "C" Vector__XXX
 SG_ PICO_BMS_FB_temperature_battery_02_12_10  m134154: 31|16@0- (0.1,0) [0|100] "C" Vector__XXX
 SG_ PICO_BMS_FB_temperature_battery_02_12_11  m134155: 31|16@0- (0.1,0) [0|100] "C" Vector__XXX
 SG_ PICO_BMS_FB_temperature_battery_02_12_12  m134156: 31|16@0- (0.1,0) [0|100] "C" Vector__XXX
 SG_ PICO_BMS_FB_temperature_battery_02_12_13  m134157: 31|16@0- (0.1,0) [0|100] "C" Vector__XXX
 SG_ PICO_BMS_FB_temperature_battery_02_12_14  m134158: 31|16@0- (0.1,0) [0|100] "C" Vector__XXX
 SG_ PICO_BMS_FB_temperature_battery_02_12_15  m134159: 31|16@0- (0.1,0) [0|100] "C" Vector__XXX
 SG_ PICO_BMS_FB_temperature_battery_02_13_00  m134400: 31|16@0- (0.1,0) [0|100] "C" Vector__XXX
 SG_ PICO_BMS_FB_temperature_battery_02_13_01  m134401: 31|16@0- (0.1,0) [0|100] "C" Vector__XXX
 SG_ PICO_BMS_FB_temperature_battery_02_13_02  m134402: 31|16@0- (0.1,0) [0|100] "C" Vector__XXX
 SG_ PICO_BMS_FB_temperature_battery_02_13_03  m134403: 31|16@0- (0.1,0) [0|100] "C" Vector__XXX
 SG_ PICO_BMS_FB_temperature_battery_02_13_04  m134404: 31|16@0- (0.1,0) [0|100] "C" Vector__XXX
 SG_ PICO_BMS_FB_temperature_battery_02_13_05  m134405: 31|16@0- (0.1,0) [0|100] "C" Vector__XXX
 SG_ PICO_BMS_FB_temperature_battery_02_13_06  m134406: 31|16@0- (0.1,0) [0|100] "C" Vector__XXX
 SG_ PICO_BMS_FB_temperature_battery_02_13_07  m134407: 31|16@0- (0.1,0) [0|100] "C" Vector__XXX
 SG_ PICO_BMS_FB_temperature_battery_02_13_08  m134408: 31|16@0- (0.1,0) [0|100] "C" Vector__XXX
 SG_ PICO_BMS_FB_temperature_battery_02_13_09  m134409: 31|16@0- (0.1,0) [0|100] "C" Vector__XXX
 SG_ PICO_BMS_FB_temperature_battery_02_13_10  m134410: 31|16@0- (0.1,0) [0|100] "C" Vector__XXX
 SG_ PICO_BMS_FB_temperature_battery_02_13_11  m134411: 31|16@0- (0.1,0) [0|100] "C" Vector__XXX
 SG_ PICO_BMS_FB_temperature_battery_02_13_12  m134412: 31|16@0- (0.1,0) [0|100] "C" Vector__XXX
 SG_ PICO_BMS_FB_temperature_battery_02_13_13  m134413: 31|16@0- (0.1,0) [0|100] "C" Vector__XXX
 SG_ PICO_BMS_FB_temperature_battery_02_13_14  m134414: 31|16@0- (0.1,0) [0|100] "C" Vector__XXX
 SG_ PICO_BMS_FB_temperature_battery_02_13_15  m134415: 31|16@0- (0.1,0) [0|100] "C" Vector__XXX
 SG_ PICO_BMS_FB_temperature_battery_02_14_00  m134656: 31|16@0- (0.1,0) [0|100] "C" Vector__XXX
 SG_ PICO_BMS_FB_temperature_battery_02_14_01  m134657: 31|16@0- (0.1,0) [0|100] "C" Vector__XXX
 SG_ PICO_BMS_FB_temperature_battery_02_14_02  m134658: 31|16@0- (0.1,0) [0|100] "C" Vector__XXX
 SG_ PICO_BMS_FB_temperature_battery_02_14_03  m134659: 31|16@0- (0.1,0) [0|100] "C" Vector__XXX
 SG_ PICO_BMS_FB_temperature_battery_02_14_04  m134660: 31|16@0- (0.1,0) [0|100] "C" Vector__XXX
 SG_ PICO_BMS_FB_temperature_battery_02_14_05  m134661: 31|16@0- (0.1,0) [0|100] "C" Vector__XXX
 SG_ PICO_BMS_FB_temperature_battery_02_14_06  m134662: 31|16@0- (0.1,0) [0|100] "C" Vector__XXX
 SG_ PICO_BMS_FB_temperature_battery_02_14_07  m134663: 31|16@0- (0.1,0) [0|100] "C" Vector__XXX
 SG_ PICO_BMS_FB_temperature_battery_02_14_08  m134664: 31|16@0- (0.1,0) [0|100] "C" Vector__XXX
 SG_ PICO_BMS_FB_temperature_battery_02_14_09  m134665: 31|16@0- (0.1,0) [0|100] "C" Vector__XXX
 SG_ PICO_BMS_FB_temperature_battery_02_14_10  m134666: 31|16@0- (0.1,0) [0|100] "C" Vector__XXX
 SG_ PICO_BMS_FB_temperature_battery_02_14_11  m134667: 31|16@0- (0.1,0) [0|100] "C" Vector__XXX
 SG_ PICO_BMS_FB_temperature_battery_02_14_12  m134668: 31|16@0- (0.1,0) [0|100] "C" Vector__XXX
 SG_ PICO_BMS_FB_temperature_battery_02_14_13  m134669: 31|16@0- (0.1,0) [0|100] "C" Vector__XXX
 SG_ PICO_BMS_FB_temperature_battery_02_14_14  m134670: 31|16@0- (0.1,0) [0|100] "C" Vector__XXX
 SG_ PICO_BMS_FB_temperature_battery_02_14_15  m134671: 31|16@0- (0.1,0) [0|100] "C" Vector__XXX
 SG_ PICO_BMS_FB_temperature_battery_02_15_00  m134912: 31|16@0- (0.1,0) [0|100] "C" Vector__XXX
 SG_ PICO_BMS_FB_temperature_battery_02_15_01  m134913: 31|16@0- (0.1,0) [0|100] "C" Vector__XXX
 SG_ PICO_BMS_FB_temperature_battery_02_15_02  m134914: 31|16@0- (0.1,0) [0|100] "C" Vector__XXX
 SG_ PICO_BMS_FB_temperature_battery_02_15_03  m134915: 31|16@0- (0.1,0) [0|100] "C" Vector__XXX
 SG_ PICO_BMS_FB_temperature_battery_02_15_04  m134916: 31|16@0- (0.1,0) [0|100] "C" Vector__XXX
 SG_ PICO_BMS_FB_temperature_battery_02_15_05  m134917: 31|16@0- (0.1,0) [0|100] "C" Vector__XXX
 SG_ PICO_BMS_FB_temperature_battery_02_15_06  m134918: 31|16@0- (0.1,0) [0|100] "C" Vector__XXX
 SG_ PICO_BMS_FB_temperature_battery_02_15_07  m134919: 31|16@0- (0.1,0) [0|100] "C" Vector__XXX
 SG_ PICO_BMS_FB_temperature_battery_02_15_08  m134920: 31|16@0- (0.1,0) [0|100] "C" Vector__XXX
 SG_ PICO_BMS_FB_temperature_battery_02_15_09  m134921: 31|16@0- (0.1,0) [0|100] "C" Vector__XXX
 SG_ PICO_BMS_FB_temperature_battery_02_15_10  m134922: 31|16@0- (0.1,0) [0|100] "C" Vector__XXX
 SG_ PICO_BMS_FB_temperature_battery_02_15_11  m134923: 31|16@0- (0.1,0) [0|100] "C" Vector__XXX
 SG_ PICO_BMS_FB_temperature_battery_02_15_12  m134924: 31|16@0- (0.1,0) [0|100] "C" Vector__XXX
 SG_ PICO_BMS_FB_temperature_battery_02_15_13  m134925: 31|16@0- (0.1,0) [0|100] "C" Vector__XXX
 SG_ PICO_BMS_FB_temperature_battery_02_15_14  m134926: 31|16@0- (0.1,0) [0|100] "C" Vector__XXX
 SG_ PICO_BMS_FB_temperature_battery_02_15_15  m134927: 31|16@0- (0.1,0) [0|100] "C" Vector__XXX
 SG_ PICO_BMS_FB_temperature_battery_03_00_00  m196608: 31|16@0- (0.1,0) [0|100] "C" Vector__XXX
 SG_ PICO_BMS_FB_temperature_battery_03_00_01  m196609: 31|16@0- (0.1,0) [0|100] "C" Vector__XXX
 SG_ PICO_BMS_FB_temperature_battery_03_00_02  m196610: 31|16@0- (0.1,0) [0|100] "C" Vector__XXX
 SG_ PICO_BMS_FB_temperature_battery_03_00_03  m196611: 31|16@0- (0.1,0) [0|100] "C" Vector__XXX
 SG_ PICO_BMS_FB_temperature_battery_03_00_04  m196612: 31|16@0- (0.1,0) [0|100] "C" Vector__XXX
 SG_ PICO_BMS_FB_temperature_battery_03_00_05  m196613: 31|16@0- (0.1,0) [0|100] "C" Vector__XXX
 SG_ PICO_BMS_FB_temperature_battery_03_00_06  m196614: 31|16@0- (0.1,0) [0|100] "C" Vector__XXX
 SG_ PICO_BMS_FB_temperature_battery_03_00_07  m196615: 31|16@0- (0.1,0) [0|100] "C" Vector__XXX
 SG_ PICO_BMS_FB_temperature_battery_03_00_08  m196616: 31|16@0- (0.1,0) [0|100] "C" Vector__XXX
 SG_ PICO_BMS_FB_temperature_battery_03_00_09  m196617: 31|16@0- (0.1,0) [0|100] "C" Vector__XXX
 SG_ PICO_BMS_FB_temperature_battery_03_00_10  m196618: 31|16@0- (0.1,0) [0|100] "C" Vector__XXX
 SG_ PICO_BMS_FB_temperature_battery_03_00_11  m196619: 31|16@0- (0.1,0) [0|100] "C" Vector__XXX
 SG_ PICO_BMS_FB_temperature_battery_03_00_12  m196620: 31|16@0- (0.1,0) [0|100] "C" Vector__XXX
 SG_ PICO_BMS_FB_temperature_battery_03_00_13  m196621: 31|16@0- (0.1,0) [0|100] "C" Vector__XXX
 SG_ PICO_BMS_FB_temperature_battery_03_00_14  m196622: 31|16@0- (0.1,0) [0|100] "C" Vector__XXX
 SG_ PICO_BMS_FB_temperature_battery_03_00_15  m196623: 31|16@0- (0.1,0) [0|100] "C" Vector__XXX
 SG_ PICO_BMS_FB_temperature_battery_03_01_00  m196864: 31|16@0- (0.1,0) [0|100] "C" Vector__XXX
 SG_ PICO_BMS_FB_temperature_battery_03_01_01  m196865: 31|16@0- (0.1,0) [0|100] "C" Vector__XXX
 SG_ PICO_BMS_FB_temperature_battery_03_01_02  m196866: 31|16@0- (0.1,0) [0|100] "C" Vector__XXX
 SG_ PICO_BMS_FB_temperature_battery_03_01_03  m196867: 31|16@0- (0.1,0) [0|100] "C" Vector__XXX
 SG_ PICO_BMS_FB_temperature_battery_03_01_04  m196868: 31|16@0- (0.1,0) [0|100] "C" Vector__XXX
 SG_ PICO_BMS_FB_temperature_battery_03_01_05  m196869: 31|16@0- (0.1,0) [0|100] "C" Vector__XXX
 SG_ PICO_BMS_FB_temperature_battery_03_01_06  m196870: 31|16@0- (0.1,0) [0|100] "C" Vector__XXX
 SG_ PICO_BMS_FB_temperature_battery_03_01_07  m196871: 31|16@0- (0.1,0) [0|100] "C" Vector__XXX
 SG_ PICO_BMS_FB_temperature_battery_03_01_08  m196872: 31|16@0- (0.1,0) [0|100] "C" Vector__XXX
 SG_ PICO_BMS_FB_temperature_battery_03_01_09  m196873: 31|16@0- (0.1,0) [0|100] "C" Vector__XXX
 SG_ PICO_BMS_FB_temperature_battery_03_01_10  m196874: 31|16@0- (0.1,0) [0|100] "C" Vector__XXX
 SG_ PICO_BMS_FB_temperature_battery_03_01_11  m196875: 31|16@0- (0.1,0) [0|100] "C" Vector__XXX
 SG_ PICO_BMS_FB_temperature_battery_03_01_12  m196876: 31|16@0- (0.1,0) [0|100] "C" Vector__XXX
 SG_ PICO_BMS_FB_temperature_battery_03_01_13  m196877: 31|16@0- (0.1,0) [0|100] "C" Vector__XXX
 SG_ PICO_BMS_FB_temperature_battery_03_01_14  m196878: 31|16@0- (0.1,0) [0|100] "C" Vector__XXX
 SG_ PICO_BMS_FB_temperature_battery_03_01_15  m196879: 31|16@0- (0.1,0) [0|100] "C" Vector__XXX
 SG_ PICO_BMS_FB_temperature_battery_03_02_00  m197120: 31|16@0- (0.1,0) [0|100] "C" Vector__XXX
 SG_ PICO_BMS_FB_temperature_battery_03_02_01  m197121: 31|16@0- (0.1,0) [0|100] "C" Vector__XXX
 SG_ PICO_BMS_FB_temperature_battery_03_02_02  m197122: 31|16@0- (0.1,0) [0|100] "C" Vector__XXX
 SG_ PICO_BMS_FB_temperature_battery_03_02_03  m197123: 31|16@0- (0.1,0) [0|100] "C" Vector__XXX
 SG_ PICO_BMS_FB_temperature_battery_03_02_04  m197124: 31|16@0- (0.1,0) [0|100] "C" Vector__XXX
 SG_ PICO_BMS_FB_temperature_battery_03_02_05  m197125: 31|16@0- (0.1,0) [0|100] "C" Vector__XXX
 SG_ PICO_BMS_FB_temperature_battery_03_02_06  m197126: 31|16@0- (0.1,0) [0|100] "C" Vector__XXX
 SG_ PICO_BMS_FB_temperature_battery_03_02_07  m197127: 31|16@0- (0.1,0) [0|100] "C" Vector__XXX
 SG_ PICO_BMS_FB_temperature_battery_03_02_08  m197128: 31|16@0- (0.1,0) [0|100] "C" Vector__XXX
 SG_ PICO_BMS_FB_temperature_battery_03_02_09  m197129: 31|16@0- (0.1,0) [0|100] "C" Vector__XXX
 SG_ PICO_BMS_FB_temperature_battery_03_02_10  m197130: 31|16@0- (0.1,0) [0|100] "C" Vector__XXX
 SG_ PICO_BMS_FB_temperature_battery_03_02_11  m197131: 31|16@0- (0.1,0) [0|100] "C" Vector__XXX
 SG_ PICO_BMS_FB_temperature_battery_03_02_12  m197132: 31|16@0- (0.1,0) [0|100] "C" Vector__XXX
 SG_ PICO_BMS_FB_temperature_battery_03_02_13  m197133: 31|16@0- (0.1,0) [0|100] "C" Vector__XXX
 SG_ PICO_BMS_FB_temperature_battery_03_02_14  m197134: 31|16@0- (0.1,0) [0|100] "C" Vector__XXX
 SG_ PICO_BMS_FB_temperature_battery_03_02_15  m197135: 31|16@0- (0.1,0) [0|100] "C" Vector__XXX
 SG_ PICO_BMS_FB_temperature_battery_03_03_00  m197376: 31|16@0- (0.1,0) [0|100] "C" Vector__XXX
 SG_ PICO_BMS_FB_temperature_battery_03_03_01  m197377: 31|16@0- (0.1,0) [0|100] "C" Vector__XXX
 SG_ PICO_BMS_FB_temperature_battery_03_03_02  m197378: 31|16@0- (0.1,0) [0|100] "C" Vector__XXX
 SG_ PICO_BMS_FB_temperature_battery_03_03_03  m197379: 31|16@0- (0.1,0) [0|100] "C" Vector__XXX
 SG_ PICO_BMS_FB_temperature_battery_03_03_04  m197380: 31|16@0- (0.1,0) [0|100] "C" Vector__XXX
 SG_ PICO_BMS_FB_temperature_battery_03_03_05  m197381: 31|16@0- (0.1,0) [0|100] "C" Vector__XXX
 SG_ PICO_BMS_FB_temperature_battery_03_03_06  m197382: 31|16@0- (0.1,0) [0|100] "C" Vector__XXX
 SG_ PICO_BMS_FB_temperature_battery_03_03_07  m197383: 31|16@0- (0.1,0) [0|100] "C" Vector__XXX
 SG_ PICO_BMS_FB_temperature_battery_03_03_08  m197384: 31|16@0- (0.1,0) [0|100] "C" Vector__XXX
 SG_ PICO_BMS_FB_temperature_battery_03_03_09  m197385: 31|16@0- (0.1,0) [0|100] "C" Vector__XXX
 SG_ PICO_BMS_FB_temperature_battery_03_03_10  m197386: 31|16@0- (0.1,0) [0|100] "C" Vector__XXX
 SG_ PICO_BMS_FB_temperature_battery_03_03_11  m197387: 31|16@0- (0.1,0) [0|100] "C" Vector__XXX
 SG_ PICO_BMS_FB_temperature_battery_03_03_12  m197388: 31|16@0- (0.1,0) [0|100] "C" Vector__XXX
 SG_ PICO_BMS_FB_temperature_battery_03_03_13  m197389: 31|16@0- (0.1,0) [0|100] "C" Vector__XXX
 SG_ PICO_BMS_FB_temperature_battery_03_03_14  m197390: 31|16@0- (0.1,0) [0|100] "C" Vector__XXX
 SG_ PICO_BMS_FB_temperature_battery_03_03_15  m197391: 31|16@0- (0.1,0) [0|100] "C" Vector__XXX
 SG_ PICO_BMS_FB_temperature_battery_03_04_00  m197632: 31|16@0- (0.1,0) [0|100] "C" Vector__XXX
 SG_ PICO_BMS_FB_temperature_battery_03_04_01  m197633: 31|16@0- (0.1,0) [0|100] "C" Vector__XXX
 SG_ PICO_BMS_FB_temperature_battery_03_04_02  m197634: 31|16@0- (0.1,0) [0|100] "C" Vector__XXX
 SG_ PICO_BMS_FB_temperature_battery_03_04_03  m197635: 31|16@0- (0.1,0) [0|100] "C" Vector__XXX
 SG_ PICO_BMS_FB_temperature_battery_03_04_04  m197636: 31|16@0- (0.1,0) [0|100] "C" Vector__XXX
 SG_ PICO_BMS_FB_temperature_battery_03_04_05  m197637: 31|16@0- (0.1,0) [0|100] "C" Vector__XXX
 SG_ PICO_BMS_FB_temperature_battery_03_04_06  m197638: 31|16@0- (0.1,0) [0|100] "C" Vector__XXX
 SG_ PICO_BMS_FB_temperature_battery_03_04_07  m197639: 31|16@0- (0.1,0) [0|100] "C" Vector__XXX
 SG_ PICO_BMS_FB_temperature_battery_03_04_08  m197640: 31|16@0- (0.1,0) [0|100] "C" Vector__XXX
 SG_ PICO_BMS_FB_temperature_battery_03_04_09  m197641: 31|16@0- (0.1,0) [0|100] "C" Vector__XXX
 SG_ PICO_BMS_FB_temperature_battery_03_04_10  m197642: 31|16@0- (0.1,0) [0|100] "C" Vector__XXX
 SG_ PICO_BMS_FB_temperature_battery_03_04_11  m197643: 31|16@0- (0.1,0) [0|100] "C" Vector__XXX
 SG_ PICO_BMS_FB_temperature_battery_03_04_12  m197644: 31|16@0- (0.1,0) [0|100] "C" Vector__XXX
 SG_ PICO_BMS_FB_temperature_battery_03_04_13  m197645: 31|16@0- (0.1,0) [0|100] "C" Vector__XXX
 SG_ PICO_BMS_FB_temperature_battery_03_04_14  m197646: 31|16@0- (0.1,0) [0|100] "C" Vector__XXX
 SG_ PICO_BMS_FB_temperature_battery_03_04_15  m197647: 31|16@0- (0.1,0) [0|100] "C" Vector__XXX
 SG_ PICO_BMS_FB_temperature_battery_03_05_00  m197888: 31|16@0- (0.1,0) [0|100] "C" Vector__XXX
 SG_ PICO_BMS_FB_temperature_battery_03_05_01  m197889: 31|16@0- (0.1,0) [0|100] "C" Vector__XXX
 SG_ PICO_BMS_FB_temperature_battery_03_05_02  m197890: 31|16@0- (0.1,0) [0|100] "C" Vector__XXX
 SG_ PICO_BMS_FB_temperature_battery_03_05_03  m197891: 31|16@0- (0.1,0) [0|100] "C" Vector__XXX
 SG_ PICO_BMS_FB_temperature_battery_03_05_04  m197892: 31|16@0- (0.1,0) [0|100] "C" Vector__XXX
 SG_ PICO_BMS_FB_temperature_battery_03_05_05  m197893: 31|16@0- (0.1,0) [0|100] "C" Vector__XXX
 SG_ PICO_BMS_FB_temperature_battery_03_05_06  m197894: 31|16@0- (0.1,0) [0|100] "C" Vector__XXX
 SG_ PICO_BMS_FB_temperature_battery_03_05_07  m197895: 31|16@0- (0.1,0) [0|100] "C" Vector__XXX
 SG_ PICO_BMS_FB_temperature_battery_03_05_08  m197896: 31|16@0- (0.1,0) [0|100] "C" Vector__XXX
 SG_ PICO_BMS_FB_temperature_battery_03_05_09  m197897: 31|16@0- (0.1,0) [0|100] "C" Vector__XXX
 SG_ PICO_BMS_FB_temperature_battery_03_05_10  m197898: 31|16@0- (0.1,0) [0|100] "C" Vector__XXX
 SG_ PICO_BMS_FB_temperature_battery_03_05_11  m197899: 31|16@0- (0.1,0) [0|100] "C" Vector__XXX
 SG_ PICO_BMS_FB_temperature_battery_03_05_12  m197900: 31|16@0- (0.1,0) [0|100] "C" Vector__XXX
 SG_ PICO_BMS_FB_temperature_battery_03_05_13  m197901: 31|16@0- (0.1,0) [0|100] "C" Vector__XXX
 SG_ PICO_BMS_FB_temperature_battery_03_05_14  m197902: 31|16@0- (0.1,0) [0|100] "C" Vector__XXX
 SG_ PICO_BMS_FB_temperature_battery_03_05_15  m197903: 31|16@0- (0.1,0) [0|100] "C" Vector__XXX
 SG_ PICO_BMS_FB_temperature_battery_03_06_00  m198144: 31|16@0- (0.1,0) [0|100] "C" Vector__XXX
 SG_ PICO_BMS_FB_temperature_battery_03_06_01  m198145: 31|16@0- (0.1,0) [0|100] "C" Vector__XXX
 SG_ PICO_BMS_FB_temperature_battery_03_06_02  m198146: 31|16@0- (0.1,0) [0|100] "C" Vector__XXX
 SG_ PICO_BMS_FB_temperature_battery_03_06_03  m198147: 31|16@0- (0.1,0) [0|100] "C" Vector__XXX
 SG_ PICO_BMS_FB_temperature_battery_03_06_04  m198148: 31|16@0- (0.1,0) [0|100] "C" Vector__XXX
 SG_ PICO_BMS_FB_temperature_battery_03_06_05  m198149: 31|16@0- (0.1,0) [0|100] "C" Vector__XXX
 SG_ PICO_BMS_FB_temperature_battery_03_06_06  m198150: 31|16@0- (0.1,0) [0|100] "C" Vector__XXX
 SG_ PICO_BMS_FB_temperature_battery_03_06_07  m198151: 31|16@0- (0.1,0) [0|100] "C" Vector__XXX
 SG_ PICO_BMS_FB_temperature_battery_03_06_08  m198152: 31|16@0- (0.1,0) [0|100] "C" Vector__XXX
 SG_ PICO_BMS_FB_temperature_battery_03_06_09  m198153: 31|16@0- (0.1,0) [0|100] "C" Vector__XXX
 SG_ PICO_BMS_FB_temperature_battery_03_06_10  m198154: 31|16@0- (0.1,0) [0|100] "C" Vector__XXX
 SG_ PICO_BMS_FB_temperature_battery_03_06_11  m198155: 31|16@0- (0.1,0) [0|100] "C" Vector__XXX
 SG_ PICO_BMS_FB_temperature_battery_03_06_12  m198156: 31|16@0- (0.1,0) [0|100] "C" Vector__XXX
 SG_ PICO_BMS_FB_temperature_battery_03_06_13  m198157: 31|16@0- (0.1,0) [0|100] "C" Vector__XXX
 SG_ PICO_BMS_FB_temperature_battery_03_06_14  m198158: 31|16@0- (0.1,0) [0|100] "C" Vector__XXX
 SG_ PICO_BMS_FB_temperature_battery_03_06_15  m198159: 31|16@0- (0.1,0) [0|100] "C" Vector__XXX
 SG_ PICO_BMS_FB_temperature_battery_03_07_00  m198400: 31|16@0- (0.1,0) [0|100] "C" Vector__XXX
 SG_ PICO_BMS_FB_temperature_battery_03_07_01  m198401: 31|16@0- (0.1,0) [0|100] "C" Vector__XXX
 SG_ PICO_BMS_FB_temperature_battery_03_07_02  m198402: 31|16@0- (0.1,0) [0|100] "C" Vector__XXX
 SG_ PICO_BMS_FB_temperature_battery_03_07_03  m198403: 31|16@0- (0.1,0) [0|100] "C" Vector__XXX
 SG_ PICO_BMS_FB_temperature_battery_03_07_04  m198404: 31|16@0- (0.1,0) [0|100] "C" Vector__XXX
 SG_ PICO_BMS_FB_temperature_battery_03_07_05  m198405: 31|16@0- (0.1,0) [0|100] "C" Vector__XXX
 SG_ PICO_BMS_FB_temperature_battery_03_07_06  m198406: 31|16@0- (0.1,0) [0|100] "C" Vector__XXX
 SG_ PICO_BMS_FB_temperature_battery_03_07_07  m198407: 31|16@0- (0.1,0) [0|100] "C" Vector__XXX
 SG_ PICO_BMS_FB_temperature_battery_03_07_08  m198408: 31|16@0- (0.1,0) [0|100] "C" Vector__XXX
 SG_ PICO_BMS_FB_temperature_battery_03_07_09  m198409: 31|16@0- (0.1,0) [0|100] "C" Vector__XXX
 SG_ PICO_BMS_FB_temperature_battery_03_07_10  m198410: 31|16@0- (0.1,0) [0|100] "C" Vector__XXX
 SG_ PICO_BMS_FB_temperature_battery_03_07_11  m198411: 31|16@0- (0.1,0) [0|100] "C" Vector__XXX
 SG_ PICO_BMS_FB_temperature_battery_03_07_12  m198412: 31|16@0- (0.1,0) [0|100] "C" Vector__XXX
 SG_ PICO_BMS_FB_temperature_battery_03_07_13  m198413: 31|16@0- (0.1,0) [0|100] "C" Vector__XXX
 SG_ PICO_BMS_FB_temperature_battery_03_07_14  m198414: 31|16@0- (0.1,0) [0|100] "C" Vector__XXX
 SG_ PICO_BMS_FB_temperature_battery_03_07_15  m198415: 31|16@0- (0.1,0) [0|100] "C" Vector__XXX
 SG_ PICO_BMS_FB_temperature_battery_03_08_00  m198656: 31|16@0- (0.1,0) [0|100] "C" Vector__XXX
 SG_ PICO_BMS_FB_temperature_battery_03_08_01  m198657: 31|16@0- (0.1,0) [0|100] "C" Vector__XXX
 SG_ PICO_BMS_FB_temperature_battery_03_08_02  m198658: 31|16@0- (0.1,0) [0|100] "C" Vector__XXX
 SG_ PICO_BMS_FB_temperature_battery_03_08_03  m198659: 31|16@0- (0.1,0) [0|100] "C" Vector__XXX
 SG_ PICO_BMS_FB_temperature_battery_03_08_04  m198660: 31|16@0- (0.1,0) [0|100] "C" Vector__XXX
 SG_ PICO_BMS_FB_temperature_battery_03_08_05  m198661: 31|16@0- (0.1,0) [0|100] "C" Vector__XXX
 SG_ PICO_BMS_FB_temperature_battery_03_08_06  m198662: 31|16@0- (0.1,0) [0|100] "C" Vector__XXX
 SG_ PICO_BMS_FB_temperature_battery_03_08_07  m198663: 31|16@0- (0.1,0) [0|100] "C" Vector__XXX
 SG_ PICO_BMS_FB_temperature_battery_03_08_08  m198664: 31|16@0- (0.1,0) [0|100] "C" Vector__XXX
 SG_ PICO_BMS_FB_temperature_battery_03_08_09  m198665: 31|16@0- (0.1,0) [0|100] "C" Vector__XXX
 SG_ PICO_BMS_FB_temperature_battery_03_08_10  m198666: 31|16@0- (0.1,0) [0|100] "C" Vector__XXX
 SG_ PICO_BMS_FB_temperature_battery_03_08_11  m198667: 31|16@0- (0.1,0) [0|100] "C" Vector__XXX
 SG_ PICO_BMS_FB_temperature_battery_03_08_12  m198668: 31|16@0- (0.1,0) [0|100] "C" Vector__XXX
 SG_ PICO_BMS_FB_temperature_battery_03_08_13  m198669: 31|16@0- (0.1,0) [0|100] "C" Vector__XXX
 SG_ PICO_BMS_FB_temperature_battery_03_08_14  m198670: 31|16@0- (0.1,0) [0|100] "C" Vector__XXX
 SG_ PICO_BMS_FB_temperature_battery_03_08_15  m198671: 31|16@0- (0.1,0) [0|100] "C" Vector__XXX
 SG_ PICO_BMS_FB_temperature_battery_03_09_00  m198912: 31|16@0- (0.1,0) [0|100] "C" Vector__XXX
 SG_ PICO_BMS_FB_temperature_battery_03_09_01  m198913: 31|16@0- (0.1,0) [0|100] "C" Vector__XXX
 SG_ PICO_BMS_FB_temperature_battery_03_09_02  m198914: 31|16@0- (0.1,0) [0|100] "C" Vector__XXX
 SG_ PICO_BMS_FB_temperature_battery_03_09_03  m198915: 31|16@0- (0.1,0) [0|100] "C" Vector__XXX
 SG_ PICO_BMS_FB_temperature_battery_03_09_04  m198916: 31|16@0- (0.1,0) [0|100] "C" Vector__XXX
 SG_ PICO_BMS_FB_temperature_battery_03_09_05  m198917: 31|16@0- (0.1,0) [0|100] "C" Vector__XXX
 SG_ PICO_BMS_FB_temperature_battery_03_09_06  m198918: 31|16@0- (0.1,0) [0|100] "C" Vector__XXX
 SG_ PICO_BMS_FB_temperature_battery_03_09_07  m198919: 31|16@0- (0.1,0) [0|100] "C" Vector__XXX
 SG_ PICO_BMS_FB_temperature_battery_03_09_08  m198920: 31|16@0- (0.1,0) [0|100] "C" Vector__XXX
 SG_ PICO_BMS_FB_temperature_battery_03_09_09  m198921: 31|16@0- (0.1,0) [0|100] "C" Vector__XXX
 SG_ PICO_BMS_FB_temperature_battery_03_09_10  m198922: 31|16@0- (0.1,0) [0|100] "C" Vector__XXX
 SG_ PICO_BMS_FB_temperature_battery_03_09_11  m198923: 31|16@0- (0.1,0) [0|100] "C" Vector__XXX
 SG_ PICO_BMS_FB_temperature_battery_03_09_12  m198924: 31|16@0- (0.1,0) [0|100] "C" Vector__XXX
 SG_ PICO_BMS_FB_temperature_battery_03_09_13  m198925: 31|16@0- (0.1,0) [0|100] "C" Vector__XXX
 SG_ PICO_BMS_FB_temperature_battery_03_09_14  m198926: 31|16@0- (0.1,0) [0|100] "C" Vector__XXX
 SG_ PICO_BMS_FB_temperature_battery_03_09_15  m198927: 31|16@0- (0.1,0) [0|100] "C" Vector__XXX
 SG_ PICO_BMS_FB_temperature_battery_03_10_00  m199168: 31|16@0- (0.1,0) [0|100] "C" Vector__XXX
 SG_ PICO_BMS_FB_temperature_battery_03_10_01  m199169: 31|16@0- (0.1,0) [0|100] "C" Vector__XXX
 SG_ PICO_BMS_FB_temperature_battery_03_10_02  m199170: 31|16@0- (0.1,0) [0|100] "C" Vector__XXX
 SG_ PICO_BMS_FB_temperature_battery_03_10_03  m199171: 31|16@0- (0.1,0) [0|100] "C" Vector__XXX
 SG_ PICO_BMS_FB_temperature_battery_03_10_04  m199172: 31|16@0- (0.1,0) [0|100] "C" Vector__XXX
 SG_ PICO_BMS_FB_temperature_battery_03_10_05  m199173: 31|16@0- (0.1,0) [0|100] "C" Vector__XXX
 SG_ PICO_BMS_FB_temperature_battery_03_10_06  m199174: 31|16@0- (0.1,0) [0|100] "C" Vector__XXX
 SG_ PICO_BMS_FB_temperature_battery_03_10_07  m199175: 31|16@0- (0.1,0) [0|100] "C" Vector__XXX
 SG_ PICO_BMS_FB_temperature_battery_03_10_08  m199176: 31|16@0- (0.1,0) [0|100] "C" Vector__XXX
 SG_ PICO_BMS_FB_temperature_battery_03_10_09  m199177: 31|16@0- (0.1,0) [0|100] "C" Vector__XXX
 SG_ PICO_BMS_FB_temperature_battery_03_10_10  m199178: 31|16@0- (0.1,0) [0|100] "C" Vector__XXX
 SG_ PICO_BMS_FB_temperature_battery_03_10_11  m199179: 31|16@0- (0.1,0) [0|100] "C" Vector__XXX
 SG_ PICO_BMS_FB_temperature_battery_03_10_12  m199180: 31|16@0- (0.1,0) [0|100] "C" Vector__XXX
 SG_ PICO_BMS_FB_temperature_battery_03_10_13  m199181: 31|16@0- (0.1,0) [0|100] "C" Vector__XXX
 SG_ PICO_BMS_FB_temperature_battery_03_10_14  m199182: 31|16@0- (0.1,0) [0|100] "C" Vector__XXX
 SG_ PICO_BMS_FB_temperature_battery_03_10_15  m199183: 31|16@0- (0.1,0) [0|100] "C" Vector__XXX
 SG_ PICO_BMS_FB_temperature_battery_03_11_00  m199424: 31|16@0- (0.1,0) [0|100] "C" Vector__XXX
 SG_ PICO_BMS_FB_temperature_battery_03_11_01  m199425: 31|16@0- (0.1,0) [0|100] "C" Vector__XXX
 SG_ PICO_BMS_FB_temperature_battery_03_11_02  m199426: 31|16@0- (0.1,0) [0|100] "C" Vector__XXX
 SG_ PICO_BMS_FB_temperature_battery_03_11_03  m199427: 31|16@0- (0.1,0) [0|100] "C" Vector__XXX
 SG_ PICO_BMS_FB_temperature_battery_03_11_04  m199428: 31|16@0- (0.1,0) [0|100] "C" Vector__XXX
 SG_ PICO_BMS_FB_temperature_battery_03_11_05  m199429: 31|16@0- (0.1,0) [0|100] "C" Vector__XXX
 SG_ PICO_BMS_FB_temperature_battery_03_11_06  m199430: 31|16@0- (0.1,0) [0|100] "C" Vector__XXX
 SG_ PICO_BMS_FB_temperature_battery_03_11_07  m199431: 31|16@0- (0.1,0) [0|100] "C" Vector__XXX
 SG_ PICO_BMS_FB_temperature_battery_03_11_08  m199432: 31|16@0- (0.1,0) [0|100] "C" Vector__XXX
 SG_ PICO_BMS_FB_temperature_battery_03_11_09  m199433: 31|16@0- (0.1,0) [0|100] "C" Vector__XXX
 SG_ PICO_BMS_FB_temperature_battery_03_11_10  m199434: 31|16@0- (0.1,0) [0|100] "C" Vector__XXX
 SG_ PICO_BMS_FB_temperature_battery_03_11_11  m199435: 31|16@0- (0.1,0) [0|100] "C" Vector__XXX
 SG_ PICO_BMS_FB_temperature_battery_03_11_12  m199436: 31|16@0- (0.1,0) [0|100] "C" Vector__XXX
 SG_ PICO_BMS_FB_temperature_battery_03_11_13  m199437: 31|16@0- (0.1,0) [0|100] "C" Vector__XXX
 SG_ PICO_BMS_FB_temperature_battery_03_11_14  m199438: 31|16@0- (0.1,0) [0|100] "C" Vector__XXX
 SG_ PICO_BMS_FB_temperature_battery_03_11_15  m199439: 31|16@0- (0.1,0) [0|100] "C" Vector__XXX
 SG_ PICO_BMS_FB_temperature_battery_03_12_00  m199680: 31|16@0- (0.1,0) [0|100] "C" Vector__XXX
 SG_ PICO_BMS_FB_temperature_battery_03_12_01  m199681: 31|16@0- (0.1,0) [0|100] "C" Vector__XXX
 SG_ PICO_BMS_FB_temperature_battery_03_12_02  m199682: 31|16@0- (0.1,0) [0|100] "C" Vector__XXX
 SG_ PICO_BMS_FB_temperature_battery_03_12_03  m199683: 31|16@0- (0.1,0) [0|100] "C" Vector__XXX
 SG_ PICO_BMS_FB_temperature_battery_03_12_04  m199684: 31|16@0- (0.1,0) [0|100] "C" Vector__XXX
 SG_ PICO_BMS_FB_temperature_battery_03_12_05  m199685: 31|16@0- (0.1,0) [0|100] "C" Vector__XXX
 SG_ PICO_BMS_FB_temperature_battery_03_12_06  m199686: 31|16@0- (0.1,0) [0|100] "C" Vector__XXX
 SG_ PICO_BMS_FB_temperature_battery_03_12_07  m199687: 31|16@0- (0.1,0) [0|100] "C" Vector__XXX
 SG_ PICO_BMS_FB_temperature_battery_03_12_08  m199688: 31|16@0- (0.1,0) [0|100] "C" Vector__XXX
 SG_ PICO_BMS_FB_temperature_battery_03_12_09  m199689: 31|16@0- (0.1,0) [0|100] "C" Vector__XXX
 SG_ PICO_BMS_FB_temperature_battery_03_12_10  m199690: 31|16@0- (0.1,0) [0|100] "C" Vector__XXX
 SG_ PICO_BMS_FB_temperature_battery_03_12_11  m199691: 31|16@0- (0.1,0) [0|100] "C" Vector__XXX
 SG_ PICO_BMS_FB_temperature_battery_03_12_12  m199692: 31|16@0- (0.1,0) [0|100] "C" Vector__XXX
 SG_ PICO_BMS_FB_temperature_battery_03_12_13  m199693: 31|16@0- (0.1,0) [0|100] "C" Vector__XXX
 SG_ PICO_BMS_FB_temperature_battery_03_12_14  m199694: 31|16@0- (0.1,0) [0|100] "C" Vector__XXX
 SG_ PICO_BMS_FB_temperature_battery_03_12_15  m199695: 31|16@0- (0.1,0) [0|100] "C" Vector__XXX
 SG_ PICO_BMS_FB_temperature_battery_03_13_00  m199936: 31|16@0- (0.1,0) [0|100] "C" Vector__XXX
 SG_ PICO_BMS_FB_temperature_battery_03_13_01  m199937: 31|16@0- (0.1,0) [0|100] "C" Vector__XXX
 SG_ PICO_BMS_FB_temperature_battery_03_13_02  m199938: 31|16@0- (0.1,0) [0|100] "C" Vector__XXX
 SG_ PICO_BMS_FB_temperature_battery_03_13_03  m199939: 31|16@0- (0.1,0) [0|100] "C" Vector__XXX
 SG_ PICO_BMS_FB_temperature_battery_03_13_04  m199940: 31|16@0- (0.1,0) [0|100] "C" Vector__XXX
 SG_ PICO_BMS_FB_temperature_battery_03_13_05  m199941: 31|16@0- (0.1,0) [0|100] "C" Vector__XXX
 SG_ PICO_BMS_FB_temperature_battery_03_13_06  m199942: 31|16@0- (0.1,0) [0|100] "C" Vector__XXX
 SG_ PICO_BMS_FB_temperature_battery_03_13_07  m199943: 31|16@0- (0.1,0) [0|100] "C" Vector__XXX
 SG_ PICO_BMS_FB_temperature_battery_03_13_08  m199944: 31|16@0- (0.1,0) [0|100] "C" Vector__XXX
 SG_ PICO_BMS_FB_temperature_battery_03_13_09  m199945: 31|16@0- (0.1,0) [0|100] "C" Vector__XXX
 SG_ PICO_BMS_FB_temperature_battery_03_13_10  m199946: 31|16@0- (0.1,0) [0|100] "C" Vector__XXX
 SG_ PICO_BMS_FB_temperature_battery_03_13_11  m199947: 31|16@0- (0.1,0) [0|100] "C" Vector__XXX
 SG_ PICO_BMS_FB_temperature_battery_03_13_12  m199948: 31|16@0- (0.1,0) [0|100] "C" Vector__XXX
 SG_ PICO_BMS_FB_temperature_battery_03_13_13  m199949: 31|16@0- (0.1,0) [0|100] "C" Vector__XXX
 SG_ PICO_BMS_FB_temperature_battery_03_13_14  m199950: 31|16@0- (0.1,0) [0|100] "C" Vector__XXX
 SG_ PICO_BMS_FB_temperature_battery_03_13_15  m199951: 31|16@0- (0.1,0) [0|100] "C" Vector__XXX
 SG_ PICO_BMS_FB_temperature_battery_03_14_00  m200192: 31|16@0- (0.1,0) [0|100] "C" Vector__XXX
 SG_ PICO_BMS_FB_temperature_battery_03_14_01  m200193: 31|16@0- (0.1,0) [0|100] "C" Vector__XXX
 SG_ PICO_BMS_FB_temperature_battery_03_14_02  m200194: 31|16@0- (0.1,0) [0|100] "C" Vector__XXX
 SG_ PICO_BMS_FB_temperature_battery_03_14_03  m200195: 31|16@0- (0.1,0) [0|100] "C" Vector__XXX
 SG_ PICO_BMS_FB_temperature_battery_03_14_04  m200196: 31|16@0- (0.1,0) [0|100] "C" Vector__XXX
 SG_ PICO_BMS_FB_temperature_battery_03_14_05  m200197: 31|16@0- (0.1,0) [0|100] "C" Vector__XXX
 SG_ PICO_BMS_FB_temperature_battery_03_14_06  m200198: 31|16@0- (0.1,0) [0|100] "C" Vector__XXX
 SG_ PICO_BMS_FB_temperature_battery_03_14_07  m200199: 31|16@0- (0.1,0) [0|100] "C" Vector__XXX
 SG_ PICO_BMS_FB_temperature_battery_03_14_08  m200200: 31|16@0- (0.1,0) [0|100] "C" Vector__XXX
 SG_ PICO_BMS_FB_temperature_battery_03_14_09  m200201: 31|16@0- (0.1,0) [0|100] "C" Vector__XXX
 SG_ PICO_BMS_FB_temperature_battery_03_14_10  m200202: 31|16@0- (0.1,0) [0|100] "C" Vector__XXX
 SG_ PICO_BMS_FB_temperature_battery_03_14_11  m200203: 31|16@0- (0.1,0) [0|100] "C" Vector__XXX
 SG_ PICO_BMS_FB_temperature_battery_03_14_12  m200204: 31|16@0- (0.1,0) [0|100] "C" Vector__XXX
 SG_ PICO_BMS_FB_temperature_battery_03_14_13  m200205: 31|16@0- (0.1,0) [0|100] "C" Vector__XXX
 SG_ PICO_BMS_FB_temperature_battery_03_14_14  m200206: 31|16@0- (0.1,0) [0|100] "C" Vector__XXX
 SG_ PICO_BMS_FB_temperature_battery_03_14_15  m200207: 31|16@0- (0.1,0) [0|100] "C" Vector__XXX
 SG_ PICO_BMS_FB_temperature_battery_03_15_00  m200448: 31|16@0- (0.1,0) [0|100] "C" Vector__XXX
 SG_ PICO_BMS_FB_temperature_battery_03_15_01  m200449: 31|16@0- (0.1,0) [0|100] "C" Vector__XXX
 SG_ PICO_BMS_FB_temperature_battery_03_15_02  m200450: 31|16@0- (0.1,0) [0|100] "C" Vector__XXX
 SG_ PICO_BMS_FB_temperature_battery_03_15_03  m200451: 31|16@0- (0.1,0) [0|100] "C" Vector__XXX
 SG_ PICO_BMS_FB_temperature_battery_03_15_04  m200452: 31|16@0- (0.1,0) [0|100] "C" Vector__XXX
 SG_ PICO_BMS_FB_temperature_battery_03_15_05  m200453: 31|16@0- (0.1,0) [0|100] "C" Vector__XXX
 SG_ PICO_BMS_FB_temperature_battery_03_15_06  m200454: 31|16@0- (0.1,0) [0|100] "C" Vector__XXX
 SG_ PICO_BMS_FB_temperature_battery_03_15_07  m200455: 31|16@0- (0.1,0) [0|100] "C" Vector__XXX
 SG_ PICO_BMS_FB_temperature_battery_03_15_08  m200456: 31|16@0- (0.1,0) [0|100] "C" Vector__XXX
 SG_ PICO_BMS_FB_temperature_battery_03_15_09  m200457: 31|16@0- (0.1,0) [0|100] "C" Vector__XXX
 SG_ PICO_BMS_FB_temperature_battery_03_15_10  m200458: 31|16@0- (0.1,0) [0|100] "C" Vector__XXX
 SG_ PICO_BMS_FB_temperature_battery_03_15_11  m200459: 31|16@0- (0.1,0) [0|100] "C" Vector__XXX
 SG_ PICO_BMS_FB_temperature_battery_03_15_12  m200460: 31|16@0- (0.1,0) [0|100] "C" Vector__XXX
 SG_ PICO_BMS_FB_temperature_battery_03_15_13  m200461: 31|16@0- (0.1,0) [0|100] "C" Vector__XXX
 SG_ PICO_BMS_FB_temperature_battery_03_15_14  m200462: 31|16@0- (0.1,0) [0|100] "C" Vector__XXX
 SG_ PICO_BMS_FB_temperature_battery_03_15_15  m200463: 31|16@0- (0.1,0) [0|100] "C" Vector__XXX
 SG_ PICO_BMS_FB_temperature_battery_04_00_00  m262144: 31|16@0- (0.1,0) [0|100] "C" Vector__XXX
 SG_ PICO_BMS_FB_temperature_battery_04_00_01  m262145: 31|16@0- (0.1,0) [0|100] "C" Vector__XXX
 SG_ PICO_BMS_FB_temperature_battery_04_00_02  m262146: 31|16@0- (0.1,0) [0|100] "C" Vector__XXX
 SG_ PICO_BMS_FB_temperature_battery_04_00_03  m262147: 31|16@0- (0.1,0) [0|100] "C" Vector__XXX
 SG_ PICO_BMS_FB_temperature_battery_04_00_04  m262148: 31|16@0- (0.1,0) [0|100] "C" Vector__XXX
 SG_ PICO_BMS_FB_temperature_battery_04_00_05  m262149: 31|16@0- (0.1,0) [0|100] "C" Vector__XXX
 SG_ PICO_BMS_FB_temperature_battery_04_00_06  m262150: 31|16@0- (0.1,0) [0|100] "C" Vector__XXX
 SG_ PICO_BMS_FB_temperature_battery_04_00_07  m262151: 31|16@0- (0.1,0) [0|100] "C" Vector__XXX
 SG_ PICO_BMS_FB_temperature_battery_04_00_08  m262152: 31|16@0- (0.1,0) [0|100] "C" Vector__XXX
 SG_ PICO_BMS_FB_temperature_battery_04_00_09  m262153: 31|16@0- (0.1,0) [0|100] "C" Vector__XXX
 SG_ PICO_BMS_FB_temperature_battery_04_00_10  m262154: 31|16@0- (0.1,0) [0|100] "C" Vector__XXX
 SG_ PICO_BMS_FB_temperature_battery_04_00_11  m262155: 31|16@0- (0.1,0) [0|100] "C" Vector__XXX
 SG_ PICO_BMS_FB_temperature_battery_04_00_12  m262156: 31|16@0- (0.1,0) [0|100] "C" Vector__XXX
 SG_ PICO_BMS_FB_temperature_battery_04_00_13  m262157: 31|16@0- (0.1,0) [0|100] "C" Vector__XXX
 SG_ PICO_BMS_FB_temperature_battery_04_00_14  m262158: 31|16@0- (0.1,0) [0|100] "C" Vector__XXX
 SG_ PICO_BMS_FB_temperature_battery_04_00_15  m262159: 31|16@0- (0.1,0) [0|100] "C" Vector__XXX
 SG_ PICO_BMS_FB_temperature_battery_04_01_00  m262400: 31|16@0- (0.1,0) [0|100] "C" Vector__XXX
 SG_ PICO_BMS_FB_temperature_battery_04_01_01  m262401: 31|16@0- (0.1,0) [0|100] "C" Vector__XXX
 SG_ PICO_BMS_FB_temperature_battery_04_01_02  m262402: 31|16@0- (0.1,0) [0|100] "C" Vector__XXX
 SG_ PICO_BMS_FB_temperature_battery_04_01_03  m262403: 31|16@0- (0.1,0) [0|100] "C" Vector__XXX
 SG_ PICO_BMS_FB_temperature_battery_04_01_04  m262404: 31|16@0- (0.1,0) [0|100] "C" Vector__XXX
 SG_ PICO_BMS_FB_temperature_battery_04_01_05  m262405: 31|16@0- (0.1,0) [0|100] "C" Vector__XXX
 SG_ PICO_BMS_FB_temperature_battery_04_01_06  m262406: 31|16@0- (0.1,0) [0|100] "C" Vector__XXX
 SG_ PICO_BMS_FB_temperature_battery_04_01_07  m262407: 31|16@0- (0.1,0) [0|100] "C" Vector__XXX
 SG_ PICO_BMS_FB_temperature_battery_04_01_08  m262408: 31|16@0- (0.1,0) [0|100] "C" Vector__XXX
 SG_ PICO_BMS_FB_temperature_battery_04_01_09  m262409: 31|16@0- (0.1,0) [0|100] "C" Vector__XXX
 SG_ PICO_BMS_FB_temperature_battery_04_01_10  m262410: 31|16@0- (0.1,0) [0|100] "C" Vector__XXX
 SG_ PICO_BMS_FB_temperature_battery_04_01_11  m262411: 31|16@0- (0.1,0) [0|100] "C" Vector__XXX
 SG_ PICO_BMS_FB_temperature_battery_04_01_12  m262412: 31|16@0- (0.1,0) [0|100] "C" Vector__XXX
 SG_ PICO_BMS_FB_temperature_battery_04_01_13  m262413: 31|16@0- (0.1,0) [0|100] "C" Vector__XXX
 SG_ PICO_BMS_FB_temperature_battery_04_01_14  m262414: 31|16@0- (0.1,0) [0|100] "C" Vector__XXX
 SG_ PICO_BMS_FB_temperature_battery_04_01_15  m262415: 31|16@0- (0.1,0) [0|100] "C" Vector__XXX
 SG_ PICO_BMS_FB_temperature_battery_04_02_00  m262656: 31|16@0- (0.1,0) [0|100] "C" Vector__XXX
 SG_ PICO_BMS_FB_temperature_battery_04_02_01  m262657: 31|16@0- (0.1,0) [0|100] "C" Vector__XXX
 SG_ PICO_BMS_FB_temperature_battery_04_02_02  m262658: 31|16@0- (0.1,0) [0|100] "C" Vector__XXX
 SG_ PICO_BMS_FB_temperature_battery_04_02_03  m262659: 31|16@0- (0.1,0) [0|100] "C" Vector__XXX
 SG_ PICO_BMS_FB_temperature_battery_04_02_04  m262660: 31|16@0- (0.1,0) [0|100] "C" Vector__XXX
 SG_ PICO_BMS_FB_temperature_battery_04_02_05  m262661: 31|16@0- (0.1,0) [0|100] "C" Vector__XXX
 SG_ PICO_BMS_FB_temperature_battery_04_02_06  m262662: 31|16@0- (0.1,0) [0|100] "C" Vector__XXX
 SG_ PICO_BMS_FB_temperature_battery_04_02_07  m262663: 31|16@0- (0.1,0) [0|100] "C" Vector__XXX
 SG_ PICO_BMS_FB_temperature_battery_04_02_08  m262664: 31|16@0- (0.1,0) [0|100] "C" Vector__XXX
 SG_ PICO_BMS_FB_temperature_battery_04_02_09  m262665: 31|16@0- (0.1,0) [0|100] "C" Vector__XXX
 SG_ PICO_BMS_FB_temperature_battery_04_02_10  m262666: 31|16@0- (0.1,0) [0|100] "C" Vector__XXX
 SG_ PICO_BMS_FB_temperature_battery_04_02_11  m262667: 31|16@0- (0.1,0) [0|100] "C" Vector__XXX
 SG_ PICO_BMS_FB_temperature_battery_04_02_12  m262668: 31|16@0- (0.1,0) [0|100] "C" Vector__XXX
 SG_ PICO_BMS_FB_temperature_battery_04_02_13  m262669: 31|16@0- (0.1,0) [0|100] "C" Vector__XXX
 SG_ PICO_BMS_FB_temperature_battery_04_02_14  m262670: 31|16@0- (0.1,0) [0|100] "C" Vector__XXX
 SG_ PICO_BMS_FB_temperature_battery_04_02_15  m262671: 31|16@0- (0.1,0) [0|100] "C" Vector__XXX
 SG_ PICO_BMS_FB_temperature_battery_04_03_00  m262912: 31|16@0- (0.1,0) [0|100] "C" Vector__XXX
 SG_ PICO_BMS_FB_temperature_battery_04_03_01  m262913: 31|16@0- (0.1,0) [0|100] "C" Vector__XXX
 SG_ PICO_BMS_FB_temperature_battery_04_03_02  m262914: 31|16@0- (0.1,0) [0|100] "C" Vector__XXX
 SG_ PICO_BMS_FB_temperature_battery_04_03_03  m262915: 31|16@0- (0.1,0) [0|100] "C" Vector__XXX
 SG_ PICO_BMS_FB_temperature_battery_04_03_04  m262916: 31|16@0- (0.1,0) [0|100] "C" Vector__XXX
 SG_ PICO_BMS_FB_temperature_battery_04_03_05  m262917: 31|16@0- (0.1,0) [0|100] "C" Vector__XXX
 SG_ PICO_BMS_FB_temperature_battery_04_03_06  m262918: 31|16@0- (0.1,0) [0|100] "C" Vector__XXX
 SG_ PICO_BMS_FB_temperature_battery_04_03_07  m262919: 31|16@0- (0.1,0) [0|100] "C" Vector__XXX
 SG_ PICO_BMS_FB_temperature_battery_04_03_08  m262920: 31|16@0- (0.1,0) [0|100] "C" Vector__XXX
 SG_ PICO_BMS_FB_temperature_battery_04_03_09  m262921: 31|16@0- (0.1,0) [0|100] "C" Vector__XXX
 SG_ PICO_BMS_FB_temperature_battery_04_03_10  m262922: 31|16@0- (0.1,0) [0|100] "C" Vector__XXX
 SG_ PICO_BMS_FB_temperature_battery_04_03_11  m262923: 31|16@0- (0.1,0) [0|100] "C" Vector__XXX
 SG_ PICO_BMS_FB_temperature_battery_04_03_12  m262924: 31|16@0- (0.1,0) [0|100] "C" Vector__XXX
 SG_ PICO_BMS_FB_temperature_battery_04_03_13  m262925: 31|16@0- (0.1,0) [0|100] "C" Vector__XXX
 SG_ PICO_BMS_FB_temperature_battery_04_03_14  m262926: 31|16@0- (0.1,0) [0|100] "C" Vector__XXX
 SG_ PICO_BMS_FB_temperature_battery_04_03_15  m262927: 31|16@0- (0.1,0) [0|100] "C" Vector__XXX
 SG_ PICO_BMS_FB_temperature_battery_04_04_00  m263168: 31|16@0- (0.1,0) [0|100] "C" Vector__XXX
 SG_ PICO_BMS_FB_temperature_battery_04_04_01  m263169: 31|16@0- (0.1,0) [0|100] "C" Vector__XXX
 SG_ PICO_BMS_FB_temperature_battery_04_04_02  m263170: 31|16@0- (0.1,0) [0|100] "C" Vector__XXX
 SG_ PICO_BMS_FB_temperature_battery_04_04_03  m263171: 31|16@0- (0.1,0) [0|100] "C" Vector__XXX
 SG_ PICO_BMS_FB_temperature_battery_04_04_04  m263172: 31|16@0- (0.1,0) [0|100] "C" Vector__XXX
 SG_ PICO_BMS_FB_temperature_battery_04_04_05  m263173: 31|16@0- (0.1,0) [0|100] "C" Vector__XXX
 SG_ PICO_BMS_FB_temperature_battery_04_04_06  m263174: 31|16@0- (0.1,0) [0|100] "C" Vector__XXX
 SG_ PICO_BMS_FB_temperature_battery_04_04_07  m263175: 31|16@0- (0.1,0) [0|100] "C" Vector__XXX
 SG_ PICO_BMS_FB_temperature_battery_04_04_08  m263176: 31|16@0- (0.1,0) [0|100] "C" Vector__XXX
 SG_ PICO_BMS_FB_temperature_battery_04_04_09  m263177: 31|16@0- (0.1,0) [0|100] "C" Vector__XXX
 SG_ PICO_BMS_FB_temperature_battery_04_04_10  m263178: 31|16@0- (0.1,0) [0|100] "C" Vector__XXX
 SG_ PICO_BMS_FB_temperature_battery_04_04_11  m263179: 31|16@0- (0.1,0) [0|100] "C" Vector__XXX
 SG_ PICO_BMS_FB_temperature_battery_04_04_12  m263180: 31|16@0- (0.1,0) [0|100] "C" Vector__XXX
 SG_ PICO_BMS_FB_temperature_battery_04_04_13  m263181: 31|16@0- (0.1,0) [0|100] "C" Vector__XXX
 SG_ PICO_BMS_FB_temperature_battery_04_04_14  m263182: 31|16@0- (0.1,0) [0|100] "C" Vector__XXX
 SG_ PICO_BMS_FB_temperature_battery_04_04_15  m263183: 31|16@0- (0.1,0) [0|100] "C" Vector__XXX
 SG_ PICO_BMS_FB_temperature_battery_04_05_00  m263424: 31|16@0- (0.1,0) [0|100] "C" Vector__XXX
 SG_ PICO_BMS_FB_temperature_battery_04_05_01  m263425: 31|16@0- (0.1,0) [0|100] "C" Vector__XXX
 SG_ PICO_BMS_FB_temperature_battery_04_05_02  m263426: 31|16@0- (0.1,0) [0|100] "C" Vector__XXX
 SG_ PICO_BMS_FB_temperature_battery_04_05_03  m263427: 31|16@0- (0.1,0) [0|100] "C" Vector__XXX
 SG_ PICO_BMS_FB_temperature_battery_04_05_04  m263428: 31|16@0- (0.1,0) [0|100] "C" Vector__XXX
 SG_ PICO_BMS_FB_temperature_battery_04_05_05  m263429: 31|16@0- (0.1,0) [0|100] "C" Vector__XXX
 SG_ PICO_BMS_FB_temperature_battery_04_05_06  m263430: 31|16@0- (0.1,0) [0|100] "C" Vector__XXX
 SG_ PICO_BMS_FB_temperature_battery_04_05_07  m263431: 31|16@0- (0.1,0) [0|100] "C" Vector__XXX
 SG_ PICO_BMS_FB_temperature_battery_04_05_08  m263432: 31|16@0- (0.1,0) [0|100] "C" Vector__XXX
 SG_ PICO_BMS_FB_temperature_battery_04_05_09  m263433: 31|16@0- (0.1,0) [0|100] "C" Vector__XXX
 SG_ PICO_BMS_FB_temperature_battery_04_05_10  m263434: 31|16@0- (0.1,0) [0|100] "C" Vector__XXX
 SG_ PICO_BMS_FB_temperature_battery_04_05_11  m263435: 31|16@0- (0.1,0) [0|100] "C" Vector__XXX
 SG_ PICO_BMS_FB_temperature_battery_04_05_12  m263436: 31|16@0- (0.1,0) [0|100] "C" Vector__XXX
 SG_ PICO_BMS_FB_temperature_battery_04_05_13  m263437: 31|16@0- (0.1,0) [0|100] "C" Vector__XXX
 SG_ PICO_BMS_FB_temperature_battery_04_05_14  m263438: 31|16@0- (0.1,0) [0|100] "C" Vector__XXX
 SG_ PICO_BMS_FB_temperature_battery_04_05_15  m263439: 31|16@0- (0.1,0) [0|100] "C" Vector__XXX
 SG_ PICO_BMS_FB_temperature_battery_04_06_00  m263680: 31|16@0- (0.1,0) [0|100] "C" Vector__XXX
 SG_ PICO_BMS_FB_temperature_battery_04_06_01  m263681: 31|16@0- (0.1,0) [0|100] "C" Vector__XXX
 SG_ PICO_BMS_FB_temperature_battery_04_06_02  m263682: 31|16@0- (0.1,0) [0|100] "C" Vector__XXX
 SG_ PICO_BMS_FB_temperature_battery_04_06_03  m263683: 31|16@0- (0.1,0) [0|100] "C" Vector__XXX
 SG_ PICO_BMS_FB_temperature_battery_04_06_04  m263684: 31|16@0- (0.1,0) [0|100] "C" Vector__XXX
 SG_ PICO_BMS_FB_temperature_battery_04_06_05  m263685: 31|16@0- (0.1,0) [0|100] "C" Vector__XXX
 SG_ PICO_BMS_FB_temperature_battery_04_06_06  m263686: 31|16@0- (0.1,0) [0|100] "C" Vector__XXX
 SG_ PICO_BMS_FB_temperature_battery_04_06_07  m263687: 31|16@0- (0.1,0) [0|100] "C" Vector__XXX
 SG_ PICO_BMS_FB_temperature_battery_04_06_08  m263688: 31|16@0- (0.1,0) [0|100] "C" Vector__XXX
 SG_ PICO_BMS_FB_temperature_battery_04_06_09  m263689: 31|16@0- (0.1,0) [0|100] "C" Vector__XXX
 SG_ PICO_BMS_FB_temperature_battery_04_06_10  m263690: 31|16@0- (0.1,0) [0|100] "C" Vector__XXX
 SG_ PICO_BMS_FB_temperature_battery_04_06_11  m263691: 31|16@0- (0.1,0) [0|100] "C" Vector__XXX
 SG_ PICO_BMS_FB_temperature_battery_04_06_12  m263692: 31|16@0- (0.1,0) [0|100] "C" Vector__XXX
 SG_ PICO_BMS_FB_temperature_battery_04_06_13  m263693: 31|16@0- (0.1,0) [0|100] "C" Vector__XXX
 SG_ PICO_BMS_FB_temperature_battery_04_06_14  m263694: 31|16@0- (0.1,0) [0|100] "C" Vector__XXX
 SG_ PICO_BMS_FB_temperature_battery_04_06_15  m263695: 31|16@0- (0.1,0) [0|100] "C" Vector__XXX
 SG_ PICO_BMS_FB_temperature_battery_04_07_00  m263936: 31|16@0- (0.1,0) [0|100] "C" Vector__XXX
 SG_ PICO_BMS_FB_temperature_battery_04_07_01  m263937: 31|16@0- (0.1,0) [0|100] "C" Vector__XXX
 SG_ PICO_BMS_FB_temperature_battery_04_07_02  m263938: 31|16@0- (0.1,0) [0|100] "C" Vector__XXX
 SG_ PICO_BMS_FB_temperature_battery_04_07_03  m263939: 31|16@0- (0.1,0) [0|100] "C" Vector__XXX
 SG_ PICO_BMS_FB_temperature_battery_04_07_04  m263940: 31|16@0- (0.1,0) [0|100] "C" Vector__XXX
 SG_ PICO_BMS_FB_temperature_battery_04_07_05  m263941: 31|16@0- (0.1,0) [0|100] "C" Vector__XXX
 SG_ PICO_BMS_FB_temperature_battery_04_07_06  m263942: 31|16@0- (0.1,0) [0|100] "C" Vector__XXX
 SG_ PICO_BMS_FB_temperature_battery_04_07_07  m263943: 31|16@0- (0.1,0) [0|100] "C" Vector__XXX
 SG_ PICO_BMS_FB_temperature_battery_04_07_08  m263944: 31|16@0- (0.1,0) [0|100] "C" Vector__XXX
 SG_ PICO_BMS_FB_temperature_battery_04_07_09  m263945: 31|16@0- (0.1,0) [0|100] "C" Vector__XXX
 SG_ PICO_BMS_FB_temperature_battery_04_07_10  m263946: 31|16@0- (0.1,0) [0|100] "C" Vector__XXX
 SG_ PICO_BMS_FB_temperature_battery_04_07_11  m263947: 31|16@0- (0.1,0) [0|100] "C" Vector__XXX
 SG_ PICO_BMS_FB_temperature_battery_04_07_12  m263948: 31|16@0- (0.1,0) [0|100] "C" Vector__XXX
 SG_ PICO_BMS_FB_temperature_battery_04_07_13  m263949: 31|16@0- (0.1,0) [0|100] "C" Vector__XXX
 SG_ PICO_BMS_FB_temperature_battery_04_07_14  m263950: 31|16@0- (0.1,0) [0|100] "C" Vector__XXX
 SG_ PICO_BMS_FB_temperature_battery_04_07_15  m263951: 31|16@0- (0.1,0) [0|100] "C" Vector__XXX
 SG_ PICO_BMS_FB_temperature_battery_04_08_00  m264192: 31|16@0- (0.1,0) [0|100] "C" Vector__XXX
 SG_ PICO_BMS_FB_temperature_battery_04_08_01  m264193: 31|16@0- (0.1,0) [0|100] "C" Vector__XXX
 SG_ PICO_BMS_FB_temperature_battery_04_08_02  m264194: 31|16@0- (0.1,0) [0|100] "C" Vector__XXX
 SG_ PICO_BMS_FB_temperature_battery_04_08_03  m264195: 31|16@0- (0.1,0) [0|100] "C" Vector__XXX
 SG_ PICO_BMS_FB_temperature_battery_04_08_04  m264196: 31|16@0- (0.1,0) [0|100] "C" Vector__XXX
 SG_ PICO_BMS_FB_temperature_battery_04_08_05  m264197: 31|16@0- (0.1,0) [0|100] "C" Vector__XXX
 SG_ PICO_BMS_FB_temperature_battery_04_08_06  m264198: 31|16@0- (0.1,0) [0|100] "C" Vector__XXX
 SG_ PICO_BMS_FB_temperature_battery_04_08_07  m264199: 31|16@0- (0.1,0) [0|100] "C" Vector__XXX
 SG_ PICO_BMS_FB_temperature_battery_04_08_08  m264200: 31|16@0- (0.1,0) [0|100] "C" Vector__XXX
 SG_ PICO_BMS_FB_temperature_battery_04_08_09  m264201: 31|16@0- (0.1,0) [0|100] "C" Vector__XXX
 SG_ PICO_BMS_FB_temperature_battery_04_08_10  m264202: 31|16@0- (0.1,0) [0|100] "C" Vector__XXX
 SG_ PICO_BMS_FB_temperature_battery_04_08_11  m264203: 31|16@0- (0.1,0) [0|100] "C" Vector__XXX
 SG_ PICO_BMS_FB_temperature_battery_04_08_12  m264204: 31|16@0- (0.1,0) [0|100] "C" Vector__XXX
 SG_ PICO_BMS_FB_temperature_battery_04_08_13  m264205: 31|16@0- (0.1,0) [0|100] "C" Vector__XXX
 SG_ PICO_BMS_FB_temperature_battery_04_08_14  m264206: 31|16@0- (0.1,0) [0|100] "C" Vector__XXX
 SG_ PICO_BMS_FB_temperature_battery_04_08_15  m264207: 31|16@0- (0.1,0) [0|100] "C" Vector__XXX
 SG_ PICO_BMS_FB_temperature_battery_04_09_00  m264448: 31|16@0- (0.1,0) [0|100] "C" Vector__XXX
 SG_ PICO_BMS_FB_temperature_battery_04_09_01  m264449: 31|16@0- (0.1,0) [0|100] "C" Vector__XXX
 SG_ PICO_BMS_FB_temperature_battery_04_09_02  m264450: 31|16@0- (0.1,0) [0|100] "C" Vector__XXX
 SG_ PICO_BMS_FB_temperature_battery_04_09_03  m264451: 31|16@0- (0.1,0) [0|100] "C" Vector__XXX
 SG_ PICO_BMS_FB_temperature_battery_04_09_04  m264452: 31|16@0- (0.1,0) [0|100] "C" Vector__XXX
 SG_ PICO_BMS_FB_temperature_battery_04_09_05  m264453: 31|16@0- (0.1,0) [0|100] "C" Vector__XXX
 SG_ PICO_BMS_FB_temperature_battery_04_09_06  m264454: 31|16@0- (0.1,0) [0|100] "C" Vector__XXX
 SG_ PICO_BMS_FB_temperature_battery_04_09_07  m264455: 31|16@0- (0.1,0) [0|100] "C" Vector__XXX
 SG_ PICO_BMS_FB_temperature_battery_04_09_08  m264456: 31|16@0- (0.1,0) [0|100] "C" Vector__XXX
 SG_ PICO_BMS_FB_temperature_battery_04_09_09  m264457: 31|16@0- (0.1,0) [0|100] "C" Vector__XXX
 SG_ PICO_BMS_FB_temperature_battery_04_09_10  m264458: 31|16@0- (0.1,0) [0|100] "C" Vector__XXX
 SG_ PICO_BMS_FB_temperature_battery_04_09_11  m264459: 31|16@0- (0.1,0) [0|100] "C" Vector__XXX
 SG_ PICO_BMS_FB_temperature_battery_04_09_12  m264460: 31|16@0- (0.1,0) [0|100] "C" Vector__XXX
 SG_ PICO_BMS_FB_temperature_battery_04_09_13  m264461: 31|16@0- (0.1,0) [0|100] "C" Vector__XXX
 SG_ PICO_BMS_FB_temperature_battery_04_09_14  m264462: 31|16@0- (0.1,0) [0|100] "C" Vector__XXX
 SG_ PICO_BMS_FB_temperature_battery_04_09_15  m264463: 31|16@0- (0.1,0) [0|100] "C" Vector__XXX
 SG_ PICO_BMS_FB_temperature_battery_04_10_00  m264704: 31|16@0- (0.1,0) [0|100] "C" Vector__XXX
 SG_ PICO_BMS_FB_temperature_battery_04_10_01  m264705: 31|16@0- (0.1,0) [0|100] "C" Vector__XXX
 SG_ PICO_BMS_FB_temperature_battery_04_10_02  m264706: 31|16@0- (0.1,0) [0|100] "C" Vector__XXX
 SG_ PICO_BMS_FB_temperature_battery_04_10_03  m264707: 31|16@0- (0.1,0) [0|100] "C" Vector__XXX
 SG_ PICO_BMS_FB_temperature_battery_04_10_04  m264708: 31|16@0- (0.1,0) [0|100] "C" Vector__XXX
 SG_ PICO_BMS_FB_temperature_battery_04_10_05  m264709: 31|16@0- (0.1,0) [0|100] "C" Vector__XXX
 SG_ PICO_BMS_FB_temperature_battery_04_10_06  m264710: 31|16@0- (0.1,0) [0|100] "C" Vector__XXX
 SG_ PICO_BMS_FB_temperature_battery_04_10_07  m264711: 31|16@0- (0.1,0) [0|100] "C" Vector__XXX
 SG_ PICO_BMS_FB_temperature_battery_04_10_08  m264712: 31|16@0- (0.1,0) [0|100] "C" Vector__XXX
 SG_ PICO_BMS_FB_temperature_battery_04_10_09  m264713: 31|16@0- (0.1,0) [0|100] "C" Vector__XXX
 SG_ PICO_BMS_FB_temperature_battery_04_10_10  m264714: 31|16@0- (0.1,0) [0|100] "C" Vector__XXX
 SG_ PICO_BMS_FB_temperature_battery_04_10_11  m264715: 31|16@0- (0.1,0) [0|100] "C" Vector__XXX
 SG_ PICO_BMS_FB_temperature_battery_04_10_12  m264716: 31|16@0- (0.1,0) [0|100] "C" Vector__XXX
 SG_ PICO_BMS_FB_temperature_battery_04_10_13  m264717: 31|16@0- (0.1,0) [0|100] "C" Vector__XXX
 SG_ PICO_BMS_FB_temperature_battery_04_10_14  m264718: 31|16@0- (0.1,0) [0|100] "C" Vector__XXX
 SG_ PICO_BMS_FB_temperature_battery_04_10_15  m264719: 31|16@0- (0.1,0) [0|100] "C" Vector__XXX
 SG_ PICO_BMS_FB_temperature_battery_04_11_00  m264960: 31|16@0- (0.1,0) [0|100] "C" Vector__XXX
 SG_ PICO_BMS_FB_temperature_battery_04_11_01  m264961: 31|16@0- (0.1,0) [0|100] "C" Vector__XXX
 SG_ PICO_BMS_FB_temperature_battery_04_11_02  m264962: 31|16@0- (0.1,0) [0|100] "C" Vector__XXX
 SG_ PICO_BMS_FB_temperature_battery_04_11_03  m264963: 31|16@0- (0.1,0) [0|100] "C" Vector__XXX
 SG_ PICO_BMS_FB_temperature_battery_04_11_04  m264964: 31|16@0- (0.1,0) [0|100] "C" Vector__XXX
 SG_ PICO_BMS_FB_temperature_battery_04_11_05  m264965: 31|16@0- (0.1,0) [0|100] "C" Vector__XXX
 SG_ PICO_BMS_FB_temperature_battery_04_11_06  m264966: 31|16@0- (0.1,0) [0|100] "C" Vector__XXX
 SG_ PICO_BMS_FB_temperature_battery_04_11_07  m264967: 31|16@0- (0.1,0) [0|100] "C" Vector__XXX
 SG_ PICO_BMS_FB_temperature_battery_04_11_08  m264968: 31|16@0- (0.1,0) [0|100] "C" Vector__XXX
 SG_ PICO_BMS_FB_temperature_battery_04_11_09  m264969: 31|16@0- (0.1,0) [0|100] "C" Vector__XXX
 SG_ PICO_BMS_FB_temperature_battery_04_11_10  m264970: 31|16@0- (0.1,0) [0|100] "C" Vector__XXX
 SG_ PICO_BMS_FB_temperature_battery_04_11_11  m264971: 31|16@0- (0.1,0) [0|100] "C" Vector__XXX
 SG_ PICO_BMS_FB_temperature_battery_04_11_12  m264972: 31|16@0- (0.1,0) [0|100] "C" Vector__XXX
 SG_ PICO_BMS_FB_temperature_battery_04_11_13  m264973: 31|16@0- (0.1,0) [0|100] "C" Vector__XXX
 SG_ PICO_BMS_FB_temperature_battery_04_11_14  m264974: 31|16@0- (0.1,0) [0|100] "C" Vector__XXX
 SG_ PICO_BMS_FB_temperature_battery_04_11_15  m264975: 31|16@0- (0.1,0) [0|100] "C" Vector__XXX
 SG_ PICO_BMS_FB_temperature_battery_04_12_00  m265216: 31|16@0- (0.1,0) [0|100] "C" Vector__XXX
 SG_ PICO_BMS_FB_temperature_battery_04_12_01  m265217: 31|16@0- (0.1,0) [0|100] "C" Vector__XXX
 SG_ PICO_BMS_FB_temperature_battery_04_12_02  m265218: 31|16@0- (0.1,0) [0|100] "C" Vector__XXX
 SG_ PICO_BMS_FB_temperature_battery_04_12_03  m265219: 31|16@0- (0.1,0) [0|100] "C" Vector__XXX
 SG_ PICO_BMS_FB_temperature_battery_04_12_04  m265220: 31|16@0- (0.1,0) [0|100] "C" Vector__XXX
 SG_ PICO_BMS_FB_temperature_battery_04_12_05  m265221: 31|16@0- (0.1,0) [0|100] "C" Vector__XXX
 SG_ PICO_BMS_FB_temperature_battery_04_12_06  m265222: 31|16@0- (0.1,0) [0|100] "C" Vector__XXX
 SG_ PICO_BMS_FB_temperature_battery_04_12_07  m265223: 31|16@0- (0.1,0) [0|100] "C" Vector__XXX
 SG_ PICO_BMS_FB_temperature_battery_04_12_08  m265224: 31|16@0- (0.1,0) [0|100] "C" Vector__XXX
 SG_ PICO_BMS_FB_temperature_battery_04_12_09  m265225: 31|16@0- (0.1,0) [0|100] "C" Vector__XXX
 SG_ PICO_BMS_FB_temperature_battery_04_12_10  m265226: 31|16@0- (0.1,0) [0|100] "C" Vector__XXX
 SG_ PICO_BMS_FB_temperature_battery_04_12_11  m265227: 31|16@0- (0.1,0) [0|100] "C" Vector__XXX
 SG_ PICO_BMS_FB_temperature_battery_04_12_12  m265228: 31|16@0- (0.1,0) [0|100] "C" Vector__XXX
 SG_ PICO_BMS_FB_temperature_battery_04_12_13  m265229: 31|16@0- (0.1,0) [0|100] "C" Vector__XXX
 SG_ PICO_BMS_FB_temperature_battery_04_12_14  m265230: 31|16@0- (0.1,0) [0|100] "C" Vector__XXX
 SG_ PICO_BMS_FB_temperature_battery_04_12_15  m265231: 31|16@0- (0.1,0) [0|100] "C" Vector__XXX
 SG_ PICO_BMS_FB_temperature_battery_04_13_00  m265472: 31|16@0- (0.1,0) [0|100] "C" Vector__XXX
 SG_ PICO_BMS_FB_temperature_battery_04_13_01  m265473: 31|16@0- (0.1,0) [0|100] "C" Vector__XXX
 SG_ PICO_BMS_FB_temperature_battery_04_13_02  m265474: 31|16@0- (0.1,0) [0|100] "C" Vector__XXX
 SG_ PICO_BMS_FB_temperature_battery_04_13_03  m265475: 31|16@0- (0.1,0) [0|100] "C" Vector__XXX
 SG_ PICO_BMS_FB_temperature_battery_04_13_04  m265476: 31|16@0- (0.1,0) [0|100] "C" Vector__XXX
 SG_ PICO_BMS_FB_temperature_battery_04_13_05  m265477: 31|16@0- (0.1,0) [0|100] "C" Vector__XXX
 SG_ PICO_BMS_FB_temperature_battery_04_13_06  m265478: 31|16@0- (0.1,0) [0|100] "C" Vector__XXX
 SG_ PICO_BMS_FB_temperature_battery_04_13_07  m265479: 31|16@0- (0.1,0) [0|100] "C" Vector__XXX
 SG_ PICO_BMS_FB_temperature_battery_04_13_08  m265480: 31|16@0- (0.1,0) [0|100] "C" Vector__XXX
 SG_ PICO_BMS_FB_temperature_battery_04_13_09  m265481: 31|16@0- (0.1,0) [0|100] "C" Vector__XXX
 SG_ PICO_BMS_FB_temperature_battery_04_13_10  m265482: 31|16@0- (0.1,0) [0|100] "C" Vector__XXX
 SG_ PICO_BMS_FB_temperature_battery_04_13_11  m265483: 31|16@0- (0.1,0) [0|100] "C" Vector__XXX
 SG_ PICO_BMS_FB_temperature_battery_04_13_12  m265484: 31|16@0- (0.1,0) [0|100] "C" Vector__XXX
 SG_ PICO_BMS_FB_temperature_battery_04_13_13  m265485: 31|16@0- (0.1,0) [0|100] "C" Vector__XXX
 SG_ PICO_BMS_FB_temperature_battery_04_13_14  m265486: 31|16@0- (0.1,0) [0|100] "C" Vector__XXX
 SG_ PICO_BMS_FB_temperature_battery_04_13_15  m265487: 31|16@0- (0.1,0) [0|100] "C" Vector__XXX
 SG_ PICO_BMS_FB_temperature_battery_04_14_00  m265728: 31|16@0- (0.1,0) [0|100] "C" Vector__XXX
 SG_ PICO_BMS_FB_temperature_battery_04_14_01  m265729: 31|16@0- (0.1,0) [0|100] "C" Vector__XXX
 SG_ PICO_BMS_FB_temperature_battery_04_14_02  m265730: 31|16@0- (0.1,0) [0|100] "C" Vector__XXX
 SG_ PICO_BMS_FB_temperature_battery_04_14_03  m265731: 31|16@0- (0.1,0) [0|100] "C" Vector__XXX
 SG_ PICO_BMS_FB_temperature_battery_04_14_04  m265732: 31|16@0- (0.1,0) [0|100] "C" Vector__XXX
 SG_ PICO_BMS_FB_temperature_battery_04_14_05  m265733: 31|16@0- (0.1,0) [0|100] "C" Vector__XXX
 SG_ PICO_BMS_FB_temperature_battery_04_14_06  m265734: 31|16@0- (0.1,0) [0|100] "C" Vector__XXX
 SG_ PICO_BMS_FB_temperature_battery_04_14_07  m265735: 31|16@0- (0.1,0) [0|100] "C" Vector__XXX
 SG_ PICO_BMS_FB_temperature_battery_04_14_08  m265736: 31|16@0- (0.1,0) [0|100] "C" Vector__XXX
 SG_ PICO_BMS_FB_temperature_battery_04_14_09  m265737: 31|16@0- (0.1,0) [0|100] "C" Vector__XXX
 SG_ PICO_BMS_FB_temperature_battery_04_14_10  m265738: 31|16@0- (0.1,0) [0|100] "C" Vector__XXX
 SG_ PICO_BMS_FB_temperature_battery_04_14_11  m265739: 31|16@0- (0.1,0) [0|100] "C" Vector__XXX
 SG_ PICO_BMS_FB_temperature_battery_04_14_12  m265740: 31|16@0- (0.1,0) [0|100] "C" Vector__XXX
 SG_ PICO_BMS_FB_temperature_battery_04_14_13  m265741: 31|16@0- (0.1,0) [0|100] "C" Vector__XXX
 SG_ PICO_BMS_FB_temperature_battery_04_14_14  m265742: 31|16@0- (0.1,0) [0|100] "C" Vector__XXX
 SG_ PICO_BMS_FB_temperature_battery_04_14_15  m265743: 31|16@0- (0.1,0) [0|100] "C" Vector__XXX
 SG_ PICO_BMS_FB_temperature_battery_04_15_00  m265984: 31|16@0- (0.1,0) [0|100] "C" Vector__XXX
 SG_ PICO_BMS_FB_temperature_battery_04_15_01  m265985: 31|16@0- (0.1,0) [0|100] "C" Vector__XXX
 SG_ PICO_BMS_FB_temperature_battery_04_15_02  m265986: 31|16@0- (0.1,0) [0|100] "C" Vector__XXX
 SG_ PICO_BMS_FB_temperature_battery_04_15_03  m265987: 31|16@0- (0.1,0) [0|100] "C" Vector__XXX
 SG_ PICO_BMS_FB_temperature_battery_04_15_04  m265988: 31|16@0- (0.1,0) [0|100] "C" Vector__XXX
 SG_ PICO_BMS_FB_temperature_battery_04_15_05  m265989: 31|16@0- (0.1,0) [0|100] "C" Vector__XXX
 SG_ PICO_BMS_FB_temperature_battery_04_15_06  m265990: 31|16@0- (0.1,0) [0|100] "C" Vector__XXX
 SG_ PICO_BMS_FB_temperature_battery_04_15_07  m265991: 31|16@0- (0.1,0) [0|100] "C" Vector__XXX
 SG_ PICO_BMS_FB_temperature_battery_04_15_08  m265992: 31|16@0- (0.1,0) [0|100] "C" Vector__XXX
 SG_ PICO_BMS_FB_temperature_battery_04_15_09  m265993: 31|16@0- (0.1,0) [0|100] "C" Vector__XXX
 SG_ PICO_BMS_FB_temperature_battery_04_15_10  m265994: 31|16@0- (0.1,0) [0|100] "C" Vector__XXX
 SG_ PICO_BMS_FB_temperature_battery_04_15_11  m265995: 31|16@0- (0.1,0) [0|100] "C" Vector__XXX
 SG_ PICO_BMS_FB_temperature_battery_04_15_12  m265996: 31|16@0- (0.1,0) [0|100] "C" Vector__XXX
 SG_ PICO_BMS_FB_temperature_battery_04_15_13  m265997: 31|16@0- (0.1,0) [0|100] "C" Vector__XXX
 SG_ PICO_BMS_FB_temperature_battery_04_15_14  m265998: 31|16@0- (0.1,0) [0|100] "C" Vector__XXX
 SG_ PICO_BMS_FB_temperature_battery_04_15_15  m265999: 31|16@0- (0.1,0) [0|100] "C" Vector__XXX
